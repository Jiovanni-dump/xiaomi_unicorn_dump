/dts-v1/;

/ {
	qcom,pmic-id = <0x2f 0x00 0x00 0x00 0x00 0x00 0x00 0x00>;
	qcom,pmic-id-size = <0x08>;
	model = "Qualcomm Technologies, Inc. Cape MTP with kiwi";
	compatible = "qcom,cape-cdp\0qcom,cape\0qcom,cdp";
	qcom,msm-id = <0x213 0x10000 0x21c 0x10000 0x212 0x10000>;
	qcom,board-id = <0x10008 0x01>;

	fragment@0 {
		target = <0xffffffff>;

		__overlay__ {
			#address-cells = <0x02>;
			#size-cells = <0x00>;
			interrupt-controller;
			#interrupt-cells = <0x04>;

			qcom,pmk8350@0 {
				compatible = "qcom,spmi-pmic";
				reg = <0x00 0x00>;
				#address-cells = <0x01>;
				#size-cells = <0x00>;
				phandle = <0x2b>;

				pon_hlos@1300 {
					compatible = "qcom,pm8998-pon";
					reg = <0x1300 0x800>;
					reg-names = "pon_hlos\0pon_pbs";
					qcom,log-kpd-event;
					phandle = <0x2c>;

					pwrkey {
						compatible = "qcom,pmk8350-pwrkey";
						interrupts = <0x00 0x13 0x07 0x03>;
						linux,code = <0x74>;
					};

					resin {
						compatible = "qcom,pmk8350-resin";
						interrupts = <0x00 0x13 0x06 0x03>;
						linux,code = <0x72>;
					};

					pwrkey-bark {
						compatible = "qcom,pmk8350-pwrkey-bark";
						interrupts = <0x00 0x13 0x00 0x03>;
						linux,code = <0x74>;
					};

					pwrkey-resin-bark {
						compatible = "qcom,pmk8350-pwrkey-resin-bark";
						interrupts = <0x00 0x13 0x02 0x03>;
						linux,code = <0x74>;
					};
				};

				vadc@3100 {
					compatible = "qcom,spmi-adc7";
					reg = <0x3100>;
					#address-cells = <0x01>;
					#size-cells = <0x00>;
					interrupts = <0x00 0x31 0x00 0x01>;
					interrupt-names = "eoc-int-en-set";
					#io-channel-cells = <0x01>;
					io-channel-ranges;
					pinctrl-names = "default";
					pinctrl-0 = <0x01>;
					phandle = <0x02>;

					pmk8350_ref_gnd {
						reg = <0x00>;
						label = "pmk8350_ref_gnd";
						qcom,pre-scaling = <0x01 0x01>;
					};

					pmk8350_vref_1p25 {
						reg = <0x01>;
						label = "pmk8350_vref_1p25";
						qcom,pre-scaling = <0x01 0x01>;
					};

					pmk8350_die_temp {
						reg = <0x03>;
						label = "pmk8350_die_temp";
						qcom,pre-scaling = <0x01 0x01>;
					};

					pm8350_ref_gnd {
						reg = <0x100>;
						label = "pm8350_ref_gnd";
						qcom,pre-scaling = <0x01 0x01>;
					};

					pm8350_vref_1p25 {
						reg = <0x101>;
						label = "pm8350_vref_1p25";
						qcom,pre-scaling = <0x01 0x01>;
					};

					pm8350_die_temp {
						reg = <0x103>;
						label = "pm8350_die_temp";
						qcom,pre-scaling = <0x01 0x01>;
					};

					pm8350_vph_pwr {
						reg = <0x18e>;
						label = "pm8350_vph_pwr";
						qcom,pre-scaling = <0x01 0x03>;
					};

					pm8350b_ref_gnd {
						reg = <0x300>;
						label = "pm8350b_ref_gnd";
						qcom,pre-scaling = <0x01 0x01>;
					};

					pm8350b_vref_1p25 {
						reg = <0x301>;
						label = "pm8350b_vref_1p25";
						qcom,pre-scaling = <0x01 0x01>;
					};

					pm8350b_die_temp {
						reg = <0x303>;
						label = "pm8350b_die_temp";
						qcom,pre-scaling = <0x01 0x01>;
					};

					pm8350b_vph_pwr {
						reg = <0x38e>;
						label = "pm8350b_vph_pwr";
						qcom,pre-scaling = <0x01 0x03>;
					};

					pm8350b_vbat_sns {
						reg = <0x38f>;
						label = "pm8350b_vbat_sns";
						qcom,pre-scaling = <0x01 0x03>;
					};

					pmr735a_ref_gnd {
						reg = <0x400>;
						label = "pmr735a_ref_gnd";
						qcom,pre-scaling = <0x01 0x01>;
					};

					pmr735a_vref_1p25 {
						reg = <0x401>;
						label = "pmr735a_vref_1p25";
						qcom,pre-scaling = <0x01 0x01>;
					};

					pmr735a_die_temp {
						reg = <0x403>;
						label = "pmr735a_die_temp";
						qcom,pre-scaling = <0x01 0x01>;
					};

					pmr735b_ref_gnd {
						reg = <0x500>;
						label = "pmr735b_ref_gnd";
						qcom,pre-scaling = <0x01 0x01>;
					};

					pmr735b_vref_1p25 {
						reg = <0x501>;
						label = "pmr735b_vref_1p25";
						qcom,pre-scaling = <0x01 0x01>;
					};

					pmr735b_die_temp {
						reg = <0x503>;
						label = "pmr735b_die_temp";
						qcom,pre-scaling = <0x01 0x01>;
					};

					pm8350b_chg_temp {
						reg = <0x310>;
						label = "pm8350b_chg_temp";
						qcom,pre-scaling = <0x01 0x01>;
					};

					pm8350b_iin_fb {
						reg = <0x317>;
						label = "pm8350b_iin_fb";
						qcom,pre-scaling = <0x20 0x64>;
					};

					pm8350b_ichg_fb {
						reg = <0x3a1>;
						label = "pm8350b_ichg_fb";
						qcom,pre-scaling = <0x3e8 0x4a821>;
					};

					pm8350b_ichg_fb_2x {
						reg = <0x3a1>;
						label = "pm8350b_ichg_fb_2x";
						qcom,pre-scaling = <0x3e8 0x95042>;
						status = "disabled";
					};

					pm8350b_ichg_fb_2p5x {
						reg = <0x3a1>;
						label = "pm8350b_ichg_fb_2p5x";
						qcom,pre-scaling = <0x3e8 0xba453>;
						status = "disabled";
					};

					pm8350b_usb_in_v_div_16 {
						reg = <0x311>;
						label = "pm8350b_usb_in_v_div_16";
						qcom,pre-scaling = <0x01 0x10>;
					};

					smb139x_1_smb_temp {
						reg = <0x906>;
						label = "smb139x_1_smb_temp";
						qcom,hw-settle-time = <0xc8>;
					};

					smb139x_1_ichg_smb {
						reg = <0x918>;
						label = "smb139x_1_ichg_smb";
						qcom,hw-settle-time = <0xc8>;
					};

					smb139x_1_iin_smb {
						reg = <0x919>;
						label = "smb139x_1_iin_smb";
						qcom,hw-settle-time = <0xc8>;
					};

					smb139x_2_smb_temp {
						reg = <0xb06>;
						label = "smb139x_2_smb_temp";
						qcom,hw-settle-time = <0xc8>;
					};

					smb139x_2_ichg_smb {
						reg = <0xb18>;
						label = "smb139x_2_ichg_smb";
						qcom,hw-settle-time = <0xc8>;
					};

					smb139x_2_iin_smb {
						reg = <0xb19>;
						label = "smb139x_2_iin_smb";
						qcom,hw-settle-time = <0xc8>;
					};
				};

				adc_tm@3400 {
					compatible = "qcom,adc-tm7";
					reg = <0x3400>;
					interrupts = <0x00 0x34 0x00 0x01>;
					interrupt-names = "threshold";
					#address-cells = <0x01>;
					#size-cells = <0x00>;
					#thermal-sensor-cells = <0x01>;
					phandle = <0x2d>;
				};

				sdam@7000 {
					compatible = "qcom,spmi-sdam";
					reg = <0x7000>;
					#address-cells = <0x01>;
					#size-cells = <0x01>;
					phandle = <0x2e>;
				};

				sdam@7100 {
					compatible = "qcom,spmi-sdam";
					reg = <0x7100>;
					#address-cells = <0x01>;
					#size-cells = <0x01>;
					phandle = <0x2f>;

					restart@48 {
						reg = <0x48 0x01>;
						bits = <0x01 0x07>;
						phandle = <0x14>;
					};

					cl_brake@7c {
						reg = <0x7c 0x01>;
						bits = <0x00 0x08>;
						phandle = <0x09>;
					};
				};

				sdam@7400 {
					compatible = "qcom,spmi-sdam";
					reg = <0x7400>;
					phandle = <0x15>;
				};

				sdam@7c00 {
					compatible = "qcom,spmi-sdam";
					reg = <0x7c00>;
					phandle = <0x0c>;
				};

				sdam@7d00 {
					compatible = "qcom,spmi-sdam";
					reg = <0x7d00>;
					phandle = <0x0d>;
				};

				sdam@8400 {
					compatible = "qcom,spmi-sdam";
					reg = <0x8400>;
					phandle = <0x04>;
				};

				sdam@8500 {
					compatible = "qcom,spmi-sdam";
					reg = <0x8500>;
					phandle = <0x05>;
				};

				sdam@8600 {
					compatible = "qcom,spmi-sdam";
					reg = <0x8600>;
					#address-cells = <0x01>;
					#size-cells = <0x01>;
					phandle = <0x30>;

					scaling@bf {
						reg = <0xbf 0x01>;
						bits = <0x00 0x02>;
						phandle = <0x31>;
					};
				};

				sdam@9800 {
					compatible = "qcom,spmi-sdam";
					reg = <0x9800>;
					phandle = <0x0e>;
				};

				sdam@9d00 {
					compatible = "qcom,spmi-sdam";
					reg = <0x9d00>;
					phandle = <0x0a>;
				};

				pinctrl@b000 {
					compatible = "qcom,pmk8350-gpio";
					reg = <0xb000>;
					gpio-controller;
					#gpio-cells = <0x02>;
					interrupt-controller;
					#interrupt-cells = <0x02>;
					phandle = <0x32>;
				};

				rtc@6100 {
					compatible = "qcom,pmk8350-rtc";
					reg = <0x6100 0x6200>;
					reg-names = "rtc\0alarm";
					interrupts = <0x00 0x62 0x01 0x01>;
					phandle = <0x33>;
				};
			};
		};
	};

	fragment@1 {
		target = <0xffffffff>;

		__overlay__ {
			#address-cells = <0x02>;
			#size-cells = <0x00>;
			interrupt-controller;
			#interrupt-cells = <0x04>;

			qcom,pm8350@1 {
				compatible = "qcom,spmi-pmic";
				reg = <0x01 0x00>;
				#address-cells = <0x01>;
				#size-cells = <0x00>;

				qcom,temp-alarm@a00 {
					compatible = "qcom,spmi-temp-alarm";
					reg = <0xa00>;
					interrupts = <0x01 0x0a 0x00 0x03>;
					#thermal-sensor-cells = <0x00>;
					io-channels = <0x02 0x103>;
					io-channel-names = "thermal";
					phandle = <0x03>;
				};

				pinctrl@8800 {
					compatible = "qcom,pm8350-gpio";
					reg = <0x8800>;
					gpio-controller;
					#gpio-cells = <0x02>;
					interrupt-controller;
					#interrupt-cells = <0x02>;
					phandle = <0x20>;

					pm8350_rear_tof_therm {

						pm8350_rear_tof_therm_default {
							pins = "gpio1";
							bias-high-impedance;
							phandle = <0x34>;
						};
					};

					key_vol_up {

						key_vol_up_default {
							pins = "gpio6";
							function = "normal";
							input-enable;
							bias-pull-up;
							power-source = <0x01>;
							phandle = <0x1f>;
						};
					};
				};
			};
		};
	};

	fragment@2 {
		target = <0xffffffff>;

		__overlay__ {

			pm8350_tz {
				polling-delay-passive = <0x64>;
				polling-delay = <0x00>;
				thermal-governor = "step_wise";
				thermal-sensors = <0x03>;
				phandle = <0x35>;

				trips {

					trip0 {
						temperature = <0x17318>;
						hysteresis = <0x00>;
						type = "passive";
						phandle = <0x1d>;
					};

					trip1 {
						temperature = <0x1c138>;
						hysteresis = <0x00>;
						type = "passive";
						phandle = <0x36>;
					};

					trip2 {
						temperature = <0x23668>;
						hysteresis = <0x00>;
						type = "passive";
						phandle = <0x37>;
					};
				};
			};
		};
	};

	fragment@3 {
		target = <0xffffffff>;

		__overlay__ {
			#address-cells = <0x02>;
			#size-cells = <0x00>;
			interrupt-controller;
			#interrupt-cells = <0x04>;

			qcom,pm8350c@2 {
				compatible = "qcom,spmi-pmic";
				reg = <0x02 0x00>;
				#address-cells = <0x01>;
				#size-cells = <0x00>;

				qcom,temp-alarm@a00 {
					compatible = "qcom,spmi-temp-alarm";
					reg = <0xa00>;
					interrupts = <0x02 0x0a 0x00 0x03>;
					#thermal-sensor-cells = <0x00>;
					phandle = <0x07>;
				};

				pinctrl@8800 {
					compatible = "qcom,pm8350c-gpio";
					reg = <0x8800>;
					gpio-controller;
					#gpio-cells = <0x02>;
					interrupt-controller;
					#interrupt-cells = <0x02>;
					phandle = <0x21>;

					lcd_backlight_ctrl {

						lcd_backlight_ctrl_default {
							pins = "gpio8";
							function = "func1";
							input-disable;
							output-enable;
							bias-disable;
							power-source = <0x01>;
							qcom,drive-strength = <0x02>;
							phandle = <0x38>;
						};
					};

					eusb2_reset_ctrl {

						eusb2_reset_ctrl_default {
							pins = "gpio7";
							function = "normal";
							input-enable;
							output-enable;
							bias-disable;
							power-source = <0x01>;
							qcom,drive-strength = <0x02>;
							phandle = <0x22>;
						};
					};
				};

				pwms@e800 {
					compatible = "qcom,pwm-lpg";
					reg = <0xe800>;
					reg-names = "lpg-base";
					#pwm-cells = <0x02>;
					qcom,num-lpg-channels = <0x03>;
					nvmem = <0x04 0x05>;
					nvmem-names = "lpg_chan_sdam\0lut_sdam";
					qcom,lut-sdam-base = <0x45>;
					qcom,lut-patterns = <0x00 0x0a 0x14 0x1e 0x28 0x32 0x3c 0x46 0x50 0x5a 0x64 0x5a 0x50 0x46 0x3c 0x32 0x28 0x1e 0x14 0x0a 0x00>;
					qcom,tick-duration-us = <0x1f40>;
					phandle = <0x06>;

					lpg@1 {
						qcom,lpg-chan-id = <0x01>;
						qcom,ramp-step-ms = <0x64>;
						qcom,ramp-low-index = <0x00>;
						qcom,ramp-high-index = <0x13>;
						qcom,ramp-pattern-repeat;
						qcom,lpg-sdam-base = <0x48>;
					};

					lpg@2 {
						qcom,lpg-chan-id = <0x02>;
						qcom,ramp-step-ms = <0x64>;
						qcom,ramp-low-index = <0x00>;
						qcom,ramp-high-index = <0x13>;
						qcom,ramp-pattern-repeat;
						qcom,lpg-sdam-base = <0x56>;
					};

					lpg@3 {
						qcom,lpg-chan-id = <0x03>;
						qcom,ramp-step-ms = <0x64>;
						qcom,ramp-low-index = <0x00>;
						qcom,ramp-high-index = <0x13>;
						qcom,ramp-pattern-repeat;
						qcom,lpg-sdam-base = <0x64>;
					};
				};

				pwms@eb00 {
					compatible = "qcom,pwm-lpg";
					reg = <0xeb00>;
					reg-names = "lpg-base";
					#pwm-cells = <0x02>;
					qcom,num-lpg-channels = <0x01>;
					phandle = <0x39>;
				};

				qcom,leds@ef00 {
					compatible = "qcom,tri-led";
					reg = <0xef00>;
					phandle = <0x3a>;

					red {
						label = "red";
						pwms = <0x06 0x00 0xf4240>;
						led-sources = <0x00>;
						linux,default-trigger = "timer";
					};

					green {
						label = "green";
						pwms = <0x06 0x01 0xf4240>;
						led-sources = <0x01>;
						linux,default-trigger = "timer";
					};

					blue {
						label = "blue";
						pwms = <0x06 0x02 0xf4240>;
						led-sources = <0x02>;
						linux,default-trigger = "timer";
					};
				};

				bcl@4700 {
					compatible = "qcom,bcl-v5";
					reg = <0x4700 0x100>;
					interrupts = <0x02 0x47 0x00 0x00 0x02 0x47 0x01 0x00 0x02 0x47 0x02 0x00>;
					interrupt-names = "bcl-lvl0\0bcl-lvl1\0bcl-lvl2";
					qcom,pmic7-threshold;
					#thermal-sensor-cells = <0x01>;
					phandle = <0x08>;
				};

				qcom,flash_led@ee00 {
					compatible = "qcom,pm8350c-flash-led";
					reg = <0xee00>;
					interrupts = <0x02 0xee 0x00 0x01 0x02 0xee 0x03 0x01 0x02 0xee 0x04 0x01>;
					interrupt-names = "led-fault-irq\0all-ramp-down-done-irq\0all-ramp-up-done-irq";
					qcom,thermal-derate-current = <0xc8 0x1f4>;
					status = "ok";
					phandle = <0x3b>;

					qcom,flash_0 {
						label = "flash";
						qcom,led-name = "led:flash_0";
						qcom,max-current-ma = <0x5dc>;
						qcom,default-led-trigger = "flash0_trigger";
						qcom,id = <0x00>;
						qcom,duration-ms = <0x500>;
						qcom,ires-ua = <0x30d4>;
						phandle = <0x3c>;
					};

					qcom,flash_1 {
						label = "flash";
						qcom,led-name = "led:flash_1";
						qcom,max-current-ma = <0x5dc>;
						qcom,default-led-trigger = "flash1_trigger";
						qcom,id = <0x01>;
						qcom,duration-ms = <0x500>;
						qcom,ires-ua = <0x30d4>;
						phandle = <0x3d>;
					};

					qcom,flash_2 {
						label = "flash";
						qcom,led-name = "led:flash_2";
						qcom,max-current-ma = <0x5dc>;
						qcom,default-led-trigger = "flash2_trigger";
						qcom,id = <0x02>;
						qcom,duration-ms = <0x500>;
						qcom,ires-ua = <0x30d4>;
						phandle = <0x3e>;
					};

					qcom,flash_3 {
						label = "flash";
						qcom,led-name = "led:flash_3";
						qcom,max-current-ma = <0x5dc>;
						qcom,default-led-trigger = "flash3_trigger";
						qcom,id = <0x03>;
						qcom,duration-ms = <0x500>;
						qcom,ires-ua = <0x30d4>;
						phandle = <0x3f>;
					};

					qcom,torch_0 {
						label = "torch";
						qcom,led-name = "led:torch_0";
						qcom,max-current-ma = <0x1f4>;
						qcom,default-led-trigger = "torch0_trigger";
						qcom,id = <0x00>;
						qcom,ires-ua = <0x30d4>;
						phandle = <0x40>;
					};

					qcom,torch_1 {
						label = "torch";
						qcom,led-name = "led:torch_1";
						qcom,max-current-ma = <0x1f4>;
						qcom,default-led-trigger = "torch1_trigger";
						qcom,id = <0x01>;
						qcom,ires-ua = <0x30d4>;
						phandle = <0x41>;
					};

					qcom,torch_2 {
						label = "torch";
						qcom,led-name = "led:torch_2";
						qcom,max-current-ma = <0x1f4>;
						qcom,default-led-trigger = "torch2_trigger";
						qcom,id = <0x02>;
						qcom,ires-ua = <0x30d4>;
						phandle = <0x42>;
					};

					qcom,torch_3 {
						label = "torch";
						qcom,led-name = "led:torch_3";
						qcom,max-current-ma = <0x1f4>;
						qcom,default-led-trigger = "torch3_trigger";
						qcom,id = <0x03>;
						qcom,ires-ua = <0x30d4>;
						phandle = <0x43>;
					};

					qcom,led_switch_0 {
						label = "switch";
						qcom,led-name = "led:switch_0";
						qcom,default-led-trigger = "switch0_trigger";
						qcom,led-mask = <0x09>;
						qcom,symmetry-en;
						phandle = <0x44>;
					};

					qcom,led_switch_1 {
						label = "switch";
						qcom,led-name = "led:switch_1";
						qcom,default-led-trigger = "switch1_trigger";
						qcom,led-mask = <0x06>;
						qcom,symmetry-en;
						phandle = <0x45>;
					};

					qcom,led_switch_2 {
						label = "switch";
						qcom,led-name = "led:switch_2";
						qcom,default-led-trigger = "switch2_trigger";
						qcom,led-mask = <0x0f>;
						qcom,symmetry-en;
						phandle = <0x46>;
					};
				};
			};
		};
	};

	fragment@4 {
		target = <0xffffffff>;

		__overlay__ {

			pm8350c_tz {
				polling-delay-passive = <0x64>;
				polling-delay = <0x00>;
				thermal-governor = "step_wise";
				thermal-sensors = <0x07>;
				phandle = <0x47>;

				trips {

					trip0 {
						temperature = <0x17318>;
						hysteresis = <0x00>;
						type = "passive";
						phandle = <0x1e>;
					};

					trip1 {
						temperature = <0x1c138>;
						hysteresis = <0x00>;
						type = "passive";
						phandle = <0x48>;
					};

					trip2 {
						temperature = <0x23668>;
						hysteresis = <0x00>;
						type = "passive";
						phandle = <0x49>;
					};
				};
			};

			pm8350c-bcl-lvl0 {
				polling-delay-passive = <0x64>;
				polling-delay = <0x00>;
				thermal-governor = "step_wise";
				thermal-sensors = <0x08 0x05>;

				trips {

					c-bcl-lvl0 {
						temperature = <0x01>;
						hysteresis = <0x01>;
						type = "passive";
						phandle = <0x19>;
					};
				};
			};

			pm8350c-bcl-lvl1 {
				polling-delay-passive = <0x64>;
				polling-delay = <0x00>;
				thermal-governor = "step_wise";
				thermal-sensors = <0x08 0x06>;

				trips {

					c-bcl-lvl1 {
						temperature = <0x01>;
						hysteresis = <0x01>;
						type = "passive";
						phandle = <0x1a>;
					};
				};
			};

			pm8350c-bcl-lvl2 {
				polling-delay-passive = <0x64>;
				polling-delay = <0x00>;
				thermal-governor = "step_wise";
				thermal-sensors = <0x08 0x07>;

				trips {

					c-bcl-lvl2 {
						temperature = <0x01>;
						hysteresis = <0x01>;
						type = "passive";
						phandle = <0x1b>;
					};
				};
			};
		};
	};

	fragment@5 {
		target = <0xffffffff>;

		__overlay__ {
			#address-cells = <0x02>;
			#size-cells = <0x00>;
			interrupt-controller;
			#interrupt-cells = <0x04>;

			qcom,pm8350b@3 {
				compatible = "qcom,spmi-pmic";
				reg = <0x03 0x00>;
				#address-cells = <0x01>;
				#size-cells = <0x00>;

				qcom,temp-alarm@a00 {
					compatible = "qcom,spmi-temp-alarm";
					reg = <0xa00>;
					interrupts = <0x03 0x0a 0x00 0x03>;
					#thermal-sensor-cells = <0x00>;
					io-channels = <0x02 0x303>;
					io-channel-names = "thermal";
					phandle = <0x0f>;
				};

				qcom,pbs@1900 {
					compatible = "qcom,qpnp-pbs";
					reg = <0x1900>;
					phandle = <0x0b>;
				};

				pinctrl@8800 {
					compatible = "qcom,pm8350b-gpio";
					reg = <0x8800>;
					gpio-controller;
					#gpio-cells = <0x02>;
					interrupt-controller;
					#interrupt-cells = <0x02>;
					phandle = <0x4a>;

					pm8350b_rear_tof_therm {

						pm8350b_rear_tof_therm_default {
							pins = "gpio2";
							bias-high-impedance;
							phandle = <0x01>;
						};
					};
				};

				bcl@4700 {
					compatible = "qcom,bcl-v5";
					reg = <0x4700 0x100>;
					interrupts = <0x03 0x47 0x00 0x00 0x03 0x47 0x01 0x00 0x03 0x47 0x02 0x00>;
					interrupt-names = "bcl-lvl0\0bcl-lvl1\0bcl-lvl2";
					qcom,pmic7-threshold;
					#thermal-sensor-cells = <0x01>;
					phandle = <0x10>;
				};

				bcl-soc {
					compatible = "qcom,msm-bcl-soc";
					#thermal-sensor-cells = <0x00>;
					phandle = <0x4b>;
				};

				qcom,hv-haptics@f000 {
					compatible = "qcom,hv-haptics";
					reg = <0xf000 0xf100 0xf200>;
					interrupts = <0x03 0xf0 0x01 0x01>;
					interrupt-names = "fifo-empty";
					qcom,vmax-mv = <0x4e2>;
					qcom,brake-mode = <0x01>;
					qcom,brake-pattern = [ff 3f 1f];
					qcom,lra-period-us = <0x16fa>;
					qcom,drv-sig-shape = <0x01>;
					qcom,brake-sig-shape = <0x01>;
					status = "ok";
					nvmem-cell-names = "hap_cl_brake";
					nvmem-cells = <0x09>;
					nvmem-names = "hap_cfg_sdam";
					nvmem = <0x0a>;
					qcom,pbs-client = <0x0b>;
					phandle = <0x4c>;

					qcom,hap-swr-slave-reg {
						regulator-name = "hap-swr-slave-reg";
						phandle = <0x4d>;
					};

					effect_0 {
						qcom,effect-id = <0x00>;
						qcom,wf-vmax-mv = <0xe10>;
						qcom,wf-pattern-data = <0x1f 0x00 0x00 0x3f 0x00 0x00 0x5f 0x00 0x00 0x7f 0x00 0x00 0x17f 0x00 0x00 0x15f 0x00 0x00 0x13f 0x00 0x00 0x11f 0x00 0x00>;
						qcom,wf-pattern-period-us = <0x1a0b>;
						qcom,wf-brake-pattern = [00 00 00];
						qcom,wf-pattern-preload;
						qcom,wf-auto-res-disable;
					};

					effect_1 {
						qcom,effect-id = <0x01>;
						qcom,wf-vmax-mv = <0xe10>;
						qcom,wf-pattern-data = <0x1f 0x00 0x00 0x3f 0x00 0x00 0x5f 0x00 0x00 0x7f 0x00 0x00 0x17f 0x00 0x00 0x15f 0x00 0x00 0x13f 0x00 0x00 0x11f 0x00 0x00>;
						qcom,wf-pattern-period-us = <0x1a0b>;
						qcom,wf-brake-pattern = [00 00 00];
						qcom,wf-auto-res-disable;
					};

					effect_2 {
						qcom,effect-id = <0x02>;
						qcom,wf-vmax-mv = <0xe10>;
						qcom,wf-pattern-data = <0x1f 0x00 0x00 0x3f 0x00 0x00 0x5f 0x00 0x00 0x7f 0x00 0x00 0x17f 0x00 0x00 0x15f 0x00 0x00 0x13f 0x00 0x00 0x11f 0x00 0x00>;
						qcom,wf-pattern-period-us = <0x1a0b>;
						qcom,wf-brake-pattern = [00 00 00];
						qcom,wf-auto-res-disable;
					};

					effect_3 {
						qcom,effect-id = <0x03>;
						qcom,wf-vmax-mv = <0xe10>;
						qcom,wf-pattern-data = <0x1f 0x00 0x00 0x3f 0x00 0x00 0x5f 0x00 0x00 0x7f 0x00 0x00 0x17f 0x00 0x00 0x15f 0x00 0x00 0x13f 0x00 0x00 0x11f 0x00 0x00>;
						qcom,wf-pattern-period-us = <0x1a0b>;
						qcom,wf-brake-pattern = [00 00 00];
						qcom,wf-auto-res-disable;
					};

					effect_4 {
						qcom,effect-id = <0x04>;
						qcom,wf-vmax-mv = <0xe10>;
						qcom,wf-pattern-data = <0x1f 0x00 0x00 0x3f 0x00 0x00 0x5f 0x00 0x00 0x7f 0x00 0x00 0x17f 0x00 0x00 0x15f 0x00 0x00 0x13f 0x00 0x00 0x11f 0x00 0x00>;
						qcom,wf-pattern-period-us = <0x1a0b>;
						qcom,wf-brake-pattern = [00 00 00];
						qcom,wf-auto-res-disable;
					};

					effect_5 {
						qcom,effect-id = <0x05>;
						qcom,wf-vmax-mv = <0xe10>;
						qcom,wf-pattern-data = <0x1f 0x00 0x00 0x3f 0x00 0x00 0x5f 0x00 0x00 0x7f 0x00 0x00 0x17f 0x00 0x00 0x15f 0x00 0x00 0x13f 0x00 0x00 0x11f 0x00 0x00>;
						qcom,wf-pattern-period-us = <0x1a0b>;
						qcom,wf-brake-pattern = [00 00 00];
						qcom,wf-auto-res-disable;
					};
				};

				qcom,amoled {
					compatible = "qcom,qpnp-amoled-regulator";
					#address-cells = <0x01>;
					#size-cells = <0x00>;
					phandle = <0x4e>;

					oledb@fa00 {
						reg = <0xfa00>;
						reg-names = "oledb_base";
						regulator-name = "oledb";
						regulator-min-microvolt = <0x4c4b40>;
						regulator-max-microvolt = <0x7a1200>;
						qcom,swire-control;
						phandle = <0x4f>;
					};

					ab@f900 {
						reg = <0xf900>;
						reg-names = "ab_base";
						regulator-name = "ab";
						regulator-min-microvolt = <0x4630c0>;
						regulator-max-microvolt = <0x4f5880>;
						qcom,swire-control;
						phandle = <0x50>;
					};

					ibb@f800 {
						reg = <0xf800>;
						reg-names = "ibb_base";
						regulator-name = "ibb";
						regulator-min-microvolt = <0x155cc0>;
						regulator-max-microvolt = <0x64b540>;
						qcom,swire-control;
						regulator-allow-set-load;
						phandle = <0x51>;
					};
				};

				qcom,amoled-ecm@f900 {
					compatible = "qcom,amoled-ecm";
					reg = <0xf900>;
					nvmem-names = "amoled-ecm-sdam0\0amoled-ecm-sdam1\0amoled-ecm-sdam2";
					nvmem = <0x0c 0x0d 0x0e>;
					interrupt-names = "ecm-sdam0\0ecm-sdam1\0ecm-sdam2";
					interrupts = <0x00 0x7c 0x01 0x01 0x00 0x7d 0x01 0x01 0x00 0x98 0x01 0x01>;
				};
			};
		};
	};

	fragment@6 {
		target = <0xffffffff>;

		__overlay__ {

			pm8350b_tz {
				polling-delay-passive = <0x64>;
				polling-delay = <0x00>;
				thermal-sensors = <0x0f>;
				phandle = <0x52>;

				trips {

					trip0 {
						temperature = <0x15f90>;
						hysteresis = <0x00>;
						type = "passive";
						phandle = <0x53>;
					};

					trip1 {
						temperature = <0x1c138>;
						hysteresis = <0x00>;
						type = "passive";
						phandle = <0x54>;
					};

					trip2 {
						temperature = <0x23668>;
						hysteresis = <0x00>;
						type = "passive";
						phandle = <0x55>;
					};
				};
			};

			pm8350b-ibat-lvl0 {
				polling-delay-passive = <0x00>;
				polling-delay = <0x00>;
				thermal-sensors = <0x10 0x00>;

				trips {

					ibat-lvl0 {
						temperature = <0x2328>;
						hysteresis = <0xc8>;
						type = "passive";
						phandle = <0x56>;
					};
				};
			};

			pm8350b-ibat-lvl1 {
				polling-delay-passive = <0x00>;
				polling-delay = <0x00>;
				thermal-sensors = <0x10 0x01>;

				trips {

					ibat-lvl1 {
						temperature = <0x2710>;
						hysteresis = <0xc8>;
						type = "passive";
						phandle = <0x57>;
					};
				};
			};

			pm8350b-bcl-lvl0 {
				polling-delay-passive = <0x64>;
				polling-delay = <0x00>;
				thermal-sensors = <0x10 0x05>;

				trips {

					thermal-engine-trip {
						temperature = <0x64>;
						hysteresis = <0x00>;
						type = "passive";
					};

					thermal-hal-trip {
						temperature = <0x64>;
						hysteresis = <0x00>;
						type = "passive";
					};

					b-bcl-lvl0 {
						temperature = <0x01>;
						hysteresis = <0x01>;
						type = "passive";
						phandle = <0x16>;
					};
				};
			};

			pm8350b-bcl-lvl1 {
				polling-delay-passive = <0x64>;
				polling-delay = <0x00>;
				thermal-sensors = <0x10 0x06>;

				trips {

					thermal-engine-trip {
						temperature = <0x64>;
						hysteresis = <0x00>;
						type = "passive";
					};

					thermal-hal-trip {
						temperature = <0x64>;
						hysteresis = <0x00>;
						type = "passive";
					};

					b-bcl-lvl1 {
						temperature = <0x01>;
						hysteresis = <0x01>;
						type = "passive";
						phandle = <0x17>;
					};
				};
			};

			pm8350b-bcl-lvl2 {
				polling-delay-passive = <0x64>;
				polling-delay = <0x00>;
				thermal-sensors = <0x10 0x07>;

				trips {

					thermal-engine-trip {
						temperature = <0x64>;
						hysteresis = <0x00>;
						type = "passive";
					};

					thermal-hal-trip {
						temperature = <0x64>;
						hysteresis = <0x00>;
						type = "passive";
					};

					b-bcl-lvl2 {
						temperature = <0x01>;
						hysteresis = <0x01>;
						type = "passive";
						phandle = <0x18>;
					};
				};
			};

			socd {
				polling-delay-passive = <0x64>;
				polling-delay = <0x00>;

				trips {

					thermal-engine-trip {
						temperature = <0x64>;
						hysteresis = <0x00>;
						type = "passive";
					};

					thermal-hal-trip {
						temperature = <0x64>;
						hysteresis = <0x00>;
						type = "passive";
					};

					socd-trip {
						temperature = <0x64>;
						hysteresis = <0x00>;
						type = "passive";
						phandle = <0x58>;
					};
				};
			};
		};
	};

	fragment@7 {
		target = <0xffffffff>;

		__overlay__ {
			#address-cells = <0x02>;
			#size-cells = <0x00>;
			interrupt-controller;
			#interrupt-cells = <0x04>;

			qcom,pmr735a@4 {
				compatible = "qcom,spmi-pmic";
				reg = <0x04 0x00>;
				#address-cells = <0x01>;
				#size-cells = <0x00>;
				phandle = <0x59>;

				qcom,temp-alarm@a00 {
					compatible = "qcom,spmi-temp-alarm";
					reg = <0xa00>;
					interrupts = <0x04 0x0a 0x00 0x03>;
					#thermal-sensor-cells = <0x00>;
					io-channels = <0x02 0x403>;
					io-channel-names = "thermal";
					phandle = <0x11>;
				};

				pinctrl@8800 {
					compatible = "qcom,pmr735a-gpio";
					reg = <0x8800>;
					gpio-controller;
					#gpio-cells = <0x02>;
					interrupt-controller;
					#interrupt-cells = <0x02>;
					phandle = <0x5a>;
				};
			};
		};
	};

	fragment@8 {
		target = <0xffffffff>;

		__overlay__ {

			pmr735a_tz {
				polling-delay-passive = <0x64>;
				polling-delay = <0x00>;
				thermal-governor = "step_wise";
				thermal-sensors = <0x11>;
				phandle = <0x5b>;

				trips {

					trip0 {
						temperature = <0x17318>;
						hysteresis = <0x00>;
						type = "passive";
						phandle = <0x5c>;
					};

					trip1 {
						temperature = <0x1c138>;
						hysteresis = <0x00>;
						type = "passive";
						phandle = <0x5d>;
					};

					trip2 {
						temperature = <0x23668>;
						hysteresis = <0x00>;
						type = "passive";
						phandle = <0x5e>;
					};
				};
			};
		};
	};

	fragment@9 {
		target = <0xffffffff>;

		__overlay__ {
			#address-cells = <0x02>;
			#size-cells = <0x00>;
			interrupt-controller;
			#interrupt-cells = <0x04>;

			qcom,pmr735b@5 {
				compatible = "qcom,spmi-pmic";
				reg = <0x05 0x00>;
				#address-cells = <0x01>;
				#size-cells = <0x00>;

				qcom,temp-alarm@a00 {
					compatible = "qcom,spmi-temp-alarm";
					reg = <0xa00>;
					interrupts = <0x05 0x0a 0x00 0x03>;
					#thermal-sensor-cells = <0x00>;
					io-channels = <0x02 0x503>;
					io-channel-names = "thermal";
					phandle = <0x12>;
				};

				pinctrl@8800 {
					compatible = "qcom,pmr735b-gpio";
					reg = <0x8800>;
					gpio-controller;
					#gpio-cells = <0x02>;
					interrupt-controller;
					#interrupt-cells = <0x02>;
					phandle = <0x5f>;
				};
			};
		};
	};

	fragment@10 {
		target = <0xffffffff>;

		__overlay__ {

			pmr735b_tz {
				polling-delay-passive = <0x64>;
				polling-delay = <0x00>;
				thermal-governor = "step_wise";
				thermal-sensors = <0x12>;
				phandle = <0x60>;

				trips {

					trip0 {
						temperature = <0x17318>;
						hysteresis = <0x00>;
						type = "passive";
						phandle = <0x61>;
					};

					trip1 {
						temperature = <0x1c138>;
						hysteresis = <0x00>;
						type = "passive";
						phandle = <0x62>;
					};

					trip2 {
						temperature = <0x23668>;
						hysteresis = <0x00>;
						type = "passive";
						phandle = <0x63>;
					};
				};
			};
		};
	};

	fragment@11 {
		target = <0xffffffff>;

		__overlay__ {
			#address-cells = <0x02>;
			#size-cells = <0x00>;
			interrupt-controller;
			#interrupt-cells = <0x04>;

			qcom,pm8450@7 {
				compatible = "qcom,spmi-pmic";
				reg = <0x07 0x00>;
				#address-cells = <0x01>;
				#size-cells = <0x00>;

				qcom,temp-alarm@a00 {
					compatible = "qcom,spmi-temp-alarm";
					reg = <0xa00>;
					interrupts = <0x07 0x0a 0x00 0x03>;
					#thermal-sensor-cells = <0x00>;
					phandle = <0x13>;
				};

				pinctrl@8800 {
					compatible = "qcom,pm8450-gpio";
					reg = <0x8800>;
					gpio-controller;
					#gpio-cells = <0x02>;
					interrupt-controller;
					#interrupt-cells = <0x02>;
					phandle = <0x64>;
				};
			};
		};
	};

	fragment@12 {
		target = <0xffffffff>;

		__overlay__ {

			pm8450_tz {
				polling-delay-passive = <0x64>;
				polling-delay = <0x00>;
				thermal-governor = "step_wise";
				thermal-sensors = <0x13>;
				phandle = <0x65>;

				trips {

					trip0 {
						temperature = <0x17318>;
						hysteresis = <0x00>;
						type = "passive";
						phandle = <0x1c>;
					};

					trip1 {
						temperature = <0x1c138>;
						hysteresis = <0x00>;
						type = "passive";
						phandle = <0x66>;
					};

					trip2 {
						temperature = <0x23668>;
						hysteresis = <0x00>;
						type = "passive";
						phandle = <0x67>;
					};
				};
			};
		};
	};

	fragment@13 {
		target = <0xffffffff>;

		__overlay__ {

			reboot_reason {
				compatible = "qcom,reboot-reason";
				nvmem-cells = <0x14>;
				nvmem-cell-names = "restart_reason";
			};

			pmic-pon-log {
				compatible = "qcom,pmic-pon-log";
				nvmem = <0x15>;
				nvmem-names = "pon_log";
			};
		};
	};

	fragment@14 {
		target = <0xffffffff>;

		__overlay__ {

			pm8350b-bcl-lvl0 {

				cooling-maps {

					vbat_lte0 {
						trip = <0x16>;
						cooling-device = <0xffffffff 0x08 0x08>;
					};

					vbat_nr0_scg {
						trip = <0x16>;
						cooling-device = <0xffffffff 0x03 0x03>;
					};

					vbat_nr0 {
						trip = <0x16>;
						cooling-device = <0xffffffff 0x06 0x06>;
					};

					vbat_cdsp0 {
						trip = <0x16>;
						cooling-device = <0xffffffff 0x02 0x02>;
					};

					vbat_cpu_5 {
						trip = <0x16>;
						cooling-device = <0xffffffff 0x01 0x01>;
					};

					vbat_gpu0 {
						trip = <0x16>;
						cooling-device = <0xffffffff 0x02 0x02>;
					};
				};
			};

			pm8350b-bcl-lvl1 {

				cooling-maps {

					vbat_lte1 {
						trip = <0x17>;
						cooling-device = <0xffffffff 0x0a 0x0a>;
					};

					vbat_nr1_scg {
						trip = <0x17>;
						cooling-device = <0xffffffff 0x0a 0x0a>;
					};

					vbat_nr1 {
						trip = <0x17>;
						cooling-device = <0xffffffff 0x09 0x09>;
					};

					vbat_cdsp1 {
						trip = <0x17>;
						cooling-device = <0xffffffff 0x04 0x04>;
					};

					vbat_cpu_6_7 {
						trip = <0x17>;
						cooling-device = <0xffffffff 0x01 0x01>;
					};

					vbat_gpu1 {
						trip = <0x17>;
						cooling-device = <0xffffffff 0x04 0x04>;
					};
				};
			};

			pm8350b-bcl-lvl2 {

				cooling-maps {

					vbat_cdsp2 {
						trip = <0x18>;
						cooling-device = <0xffffffff 0x05 0xffffffff>;
					};

					vbat_gpu2 {
						trip = <0x18>;
						cooling-device = <0xffffffff 0x07 0xffffffff>;
					};
				};
			};

			pm8350c-bcl-lvl0 {

				cooling-maps {

					vph_lte0 {
						trip = <0x19>;
						cooling-device = <0xffffffff 0x08 0x08>;
					};

					vph_nr0_scg {
						trip = <0x19>;
						cooling-device = <0xffffffff 0x03 0x03>;
					};

					vph_nr0 {
						trip = <0x19>;
						cooling-device = <0xffffffff 0x06 0x06>;
					};

					vph_cdsp0 {
						trip = <0x19>;
						cooling-device = <0xffffffff 0x02 0x02>;
					};

					vph_cpu_5 {
						trip = <0x19>;
						cooling-device = <0xffffffff 0x01 0x01>;
					};

					vph_gpu0 {
						trip = <0x19>;
						cooling-device = <0xffffffff 0x02 0x02>;
					};
				};
			};

			pm8350c-bcl-lvl1 {

				cooling-maps {

					vph_lte1 {
						trip = <0x1a>;
						cooling-device = <0xffffffff 0x0a 0x0a>;
					};

					vph_nr1_scg {
						trip = <0x1a>;
						cooling-device = <0xffffffff 0x0a 0x0a>;
					};

					vph_nr1 {
						trip = <0x1a>;
						cooling-device = <0xffffffff 0x09 0x09>;
					};

					vph_cdsp1 {
						trip = <0x1a>;
						cooling-device = <0xffffffff 0x04 0x04>;
					};

					vph_cpu_6_7 {
						trip = <0x1a>;
						cooling-device = <0xffffffff 0x01 0x01>;
					};

					vph_gpu1 {
						trip = <0x1a>;
						cooling-device = <0xffffffff 0x04 0x04>;
					};
				};
			};

			pm8350c-bcl-lvl2 {

				cooling-maps {

					vph_cdsp2 {
						trip = <0x1b>;
						cooling-device = <0xffffffff 0x05 0xffffffff>;
					};

					vph_gpu2 {
						trip = <0x1b>;
						cooling-device = <0xffffffff 0x07 0xffffffff>;
					};
				};
			};

			pm8450_tz {

				cooling-maps {

					pm8450_cpu4_freq {
						trip = <0x1c>;
						cooling-device = <0xffffffff 0x0f 0xffffffff>;
					};

					pm8450_cpu5_freq {
						trip = <0x1c>;
						cooling-device = <0xffffffff 0x0f 0xffffffff>;
					};

					pm8450_cpu6_freq {
						trip = <0x1c>;
						cooling-device = <0xffffffff 0x0f 0xffffffff>;
					};

					pm8450_cpu7_freq {
						trip = <0x1c>;
						cooling-device = <0xffffffff 0x0f 0xffffffff>;
					};

					pm8450_apc1 {
						trip = <0x1c>;
						cooling-device = <0xffffffff 0x01 0x01>;
					};
				};
			};

			pm8350_tz {

				cooling-maps {

					pm8350_gpu {
						trip = <0x1d>;
						cooling-device = <0xffffffff 0x07 0xffffffff>;
					};

					pm8350_cpu4_freq {
						trip = <0x1d>;
						cooling-device = <0xffffffff 0x0f 0xffffffff>;
					};

					pm8350_cpu5_freq {
						trip = <0x1d>;
						cooling-device = <0xffffffff 0x0f 0xffffffff>;
					};

					pm8350_cpu6_freq {
						trip = <0x1d>;
						cooling-device = <0xffffffff 0x0f 0xffffffff>;
					};

					pm8350_cpu7_freq {
						trip = <0x1d>;
						cooling-device = <0xffffffff 0x0f 0xffffffff>;
					};

					pm8350_apc1 {
						trip = <0x1d>;
						cooling-device = <0xffffffff 0x01 0x01>;
					};
				};
			};

			pm8350c_tz {

				cooling-maps {

					pm8350c_nsp {
						trip = <0x1e>;
						cooling-device = <0xffffffff 0x05 0xffffffff>;
					};

					pm8350c_lte {
						trip = <0x1e>;
						cooling-device = <0xffffffff 0xff 0xff>;
					};

					pm8350c_nr {
						trip = <0x1e>;
						cooling-device = <0xffffffff 0xff 0xff>;
					};
				};
			};
		};
	};

	fragment@15 {
		target = <0xffffffff>;

		__overlay__ {

			gpio_keys {
				compatible = "gpio-keys";
				label = "gpio-keys";
				pinctrl-names = "default";
				pinctrl-0 = <0x1f>;

				vol_up {
					label = "volume_up";
					gpios = <0x20 0x06 0x01>;
					linux,input-type = <0x01>;
					linux,code = <0x73>;
					gpio-key,wakeup;
					debounce-interval = <0x0f>;
					linux,can-disable;
				};
			};
		};
	};

	fragment@16 {
		target = <0xffffffff>;

		__overlay__ {
			status = "ok";
			vdd-supply = <0xffffffff>;
			qcom,vdd-voltage-level = <0x2d2a80 0x2d2a80>;
			qcom,vdd-current-level = <0x00 0xc3500>;
			vdd-io-supply = <0xffffffff>;
			qcom,vdd-io-voltage-level = <0x1b7740 0x2d2a80>;
			qcom,vdd-io-current-level = <0x00 0x1e848>;
			pinctrl-names = "default\0sleep";
			pinctrl-0 = <0xffffffff>;
			pinctrl-1 = <0xffffffff>;
			cd-gpios = <0xffffffff 0x5c 0x01>;
		};
	};

	fragment@17 {
		target = <0xffffffff>;

		__overlay__ {
			compatible = "qcom,ufs-phy-qmp-v4-cape";
			vdda-phy-supply = <0xffffffff>;
			vdda-pll-supply = <0xffffffff>;
			vdda-phy-max-microamp = <0x30188>;
			vdda-pll-max-microamp = <0x5c94>;
			status = "ok";
		};
	};

	fragment@18 {
		target = <0xffffffff>;

		__overlay__ {
			vdd-hba-supply = <0xffffffff>;
			vcc-supply = <0xffffffff>;
			vcc-max-microamp = <0x10c8e0>;
			vccq-supply = <0xffffffff>;
			vccq-max-microamp = <0x124f80>;
			qcom,vddp-ref-clk-supply = <0xffffffff>;
			qcom,vddp-ref-clk-max-microamp = <0x64>;
			status = "ok";
		};
	};

	fragment@19 {
		target = <0xffffffff>;

		__overlay__ {
			qcom,thermal-mitigation = <0x2dc6c0 0x16e360 0xf4240 0x7a120>;
			qcom,wireless-fw-name = "idt9415.bin";
		};
	};

	fragment@20 {
		target = <0xffffffff>;

		__overlay__ {
			status = "ok";
			qcom,clk-freq-out = <0xf4240>;
			#address-cells = <0x01>;
			#size-cells = <0x00>;

			nq@28 {
				compatible = "qcom,sn-nci";
				reg = <0x28>;
				qcom,sn-irq = <0xffffffff 0x2e 0x00>;
				qcom,sn-ven = <0xffffffff 0x22 0x00>;
				qcom,sn-firm = <0xffffffff 0x2d 0x00>;
				qcom,sn-clkreq = <0xffffffff 0x23 0x00>;
				qcom,sn-vdd-1p8-supply = <0xffffffff>;
				qcom,sn-vdd-1p8-voltage = <0x1b7740 0x1b7740>;
				qcom,sn-vdd-1p8-current = <0x26548>;
				interrupt-parent = <0xffffffff>;
				interrupts = <0x2e 0x00>;
				interrupt-names = "nfc_irq";
				pinctrl-names = "nfc_active\0nfc_suspend";
				pinctrl-0 = <0xffffffff 0xffffffff>;
				pinctrl-1 = <0xffffffff 0xffffffff>;
			};
		};
	};

	fragment@21 {
		target = <0xffffffff>;

		__overlay__ {
			status = "ok";
			#address-cells = <0x01>;
			#size-cells = <0x00>;
			qcom,spi-touch-active = "focaltech,fts_ts";

			focaltech@0 {
				compatible = "focaltech,fts_ts";
				reg = <0x00>;
				spi-max-frequency = <0x5b8d80>;
				interrupt-parent = <0xffffffff>;
				interrupts = <0x15 0x2008>;
				focaltech,reset-gpio = <0xffffffff 0x14 0x00>;
				focaltech,irq-gpio = <0xffffffff 0x15 0x2008>;
				focaltech,display-coords = <0x00 0x00 0x438 0x924>;
				focaltech,max-touch-number = <0x05>;
				focaltech,ic-type = <0x3658d488>;
				focaltech,touch-type = "primary";
				vdd-supply = <0xffffffff>;
				pinctrl-names = "pmx_ts_active\0pmx_ts_suspend\0pmx_ts_release";
				pinctrl-0 = <0xffffffff>;
				pinctrl-1 = <0xffffffff 0xffffffff>;
				pinctrl-2 = <0xffffffff>;
			};
		};
	};

	fragment@22 {
		target = <0xffffffff>;

		__overlay__ {
			status = "ok";
			#address-cells = <0x01>;
			#size-cells = <0x00>;

			eusb2_repeater@4f {
				compatible = "nxp,eusb2-repeater";
				reg = <0x4f>;
				vdd18-supply = <0xffffffff>;
				vdd3-supply = <0xffffffff>;
				reset-gpio = <0x21 0x07 0x00>;
				pinctrl-names = "default";
				pinctrl-0 = <0x22>;
				qcom,param-override-seq = <0x40 0x06 0x22 0x07 0x63 0x08>;
				phandle = <0x23>;
			};
		};
	};

	fragment@23 {
		target = <0xffffffff>;

		__overlay__ {
			dummy-supply = <0x23>;
			usb-repeater = <0x23>;
		};
	};

	fragment@24 {
		target = <0xffffffff>;

		__overlay__ {
			usb-role-switch;

			dwc3@a600000 {
				usb-role-switch;
			};

			port {

				endpoint {
					remote-endpoint = <0x24>;
					phandle = <0x25>;
				};
			};
		};
	};

	fragment@25 {
		target = <0xffffffff>;

		__overlay__ {

			connector {

				port {

					endpoint {
						remote-endpoint = <0x25>;
						phandle = <0x24>;
					};
				};
			};
		};
	};

	fragment@26 {
		target = <0xffffffff>;

		__overlay__ {

			pm8350b-bcl-lvl2 {

				cooling-maps {

					vbat_gpu2 {
						cooling-device = <0xffffffff 0x09 0x09>;
					};
				};
			};

			pm8350c-bcl-lvl2 {

				cooling-maps {

					vph_gpu2 {
						cooling-device = <0xffffffff 0x09 0x09>;
					};
				};
			};
		};
	};

	fragment@27 {
		target = <0xffffffff>;

		__overlay__ {
			qcom,critical-devices = <0xffffffff>;
		};
	};

	fragment@28 {
		target = <0xffffffff>;

		__overlay__ {
			#address-cells = <0x01>;
			#size-cells = <0x00>;
			status = "ok";

			pm8008i@8 {
				compatible = "qcom,i2c-pmic";
				reg = <0x08>;
				#address-cells = <0x01>;
				#size-cells = <0x00>;
				pinctrl-names = "default";
				pinctrl-0 = <0xffffffff>;

				pm8008-chip@900 {
					compatible = "qcom,pm8008-chip";
					reg = <0x900>;

					qcom,pm8008-chip-en {
						regulator-name = "pm8008i-chip-en";
						phandle = <0x26>;
					};
				};

				qcom,revid@100 {
					compatible = "qcom,qpnp-revid";
					reg = <0x100>;
				};
			};

			pm8008i@9 {
				compatible = "qcom,i2c-pmic";
				reg = <0x09>;
				#address-cells = <0x01>;
				#size-cells = <0x00>;

				qcom,pm8008i-regulator {
					compatible = "qcom,pm8008-regulator";
					#address-cells = <0x01>;
					#size-cells = <0x00>;
					pm8008_en-supply = <0x26>;
					vdd_l1_l2-supply = <0xffffffff>;
					vdd_l3_l4-supply = <0xffffffff>;
					vdd_l5-supply = <0xffffffff>;
					vdd_l6-supply = <0xffffffff>;
					vdd_l7-supply = <0xffffffff>;

					regulator@4000 {
						reg = <0x4000>;
						regulator-name = "pm8008i_l1";
						regulator-min-microvolt = "\0\aS";
						regulator-max-microvolt = <0x10d880>;
						qcom,min-dropout-voltage = <0x5dc0>;
						qcom,hpm-min-load = <0x00>;
						phandle = <0x68>;
					};

					regulator@4100 {
						reg = <0x4100>;
						regulator-name = "pm8008i_l2";
						regulator-min-microvolt = <0x101d00>;
						regulator-max-microvolt = <0x101d00>;
						qcom,min-dropout-voltage = <0xdac0>;
						qcom,hpm-min-load = <0x00>;
						phandle = <0x69>;
					};

					regulator@4200 {
						reg = <0x4200>;
						regulator-name = "pm8008i_l3";
						regulator-min-microvolt = "\0*{";
						regulator-max-microvolt = <0x2c4fc0>;
						qcom,min-dropout-voltage = <0x36b00>;
						qcom,hpm-min-load = <0x00>;
						phandle = <0x6a>;
					};

					regulator@4300 {
						reg = <0x4300>;
						regulator-name = "pm8008i_l4";
						regulator-min-microvolt = <0x2ab980>;
						regulator-max-microvolt = <0x2ab980>;
						qcom,min-dropout-voltage = <0x251c0>;
						qcom,hpm-min-load = <0x00>;
						phandle = <0x6b>;
					};

					regulator@4400 {
						reg = <0x4400>;
						regulator-name = "pm8008i_l5";
						regulator-min-microvolt = <0x1b1980>;
						regulator-max-microvolt = <0x1b7740>;
						qcom,min-dropout-voltage = <0x5dc0>;
						qcom,hpm-min-load = <0x00>;
						phandle = <0x6c>;
					};

					regulator@4500 {
						reg = <0x4500>;
						regulator-name = "pm8008i_l6";
						regulator-min-microvolt = <0x2ab980>;
						regulator-max-microvolt = <0x2ab980>;
						qcom,min-dropout-voltage = <0x32c80>;
						qcom,hpm-min-load = <0x00>;
						phandle = <0x6d>;
					};

					regulator@4600 {
						reg = <0x4600>;
						regulator-name = "pm8008i_l7";
						regulator-min-microvolt = <0x2961c0>;
						regulator-max-microvolt = <0x2d2a80>;
						qcom,min-dropout-voltage = <0x48440>;
						qcom,hpm-min-load = <0x00>;
						phandle = <0x6e>;
					};
				};
			};

			pm8008j@c {
				compatible = "qcom,i2c-pmic";
				reg = <0x0c>;
				#address-cells = <0x01>;
				#size-cells = <0x00>;
				pinctrl-names = "default";
				pinctrl-0 = <0xffffffff>;

				pm8008-chip@900 {
					compatible = "qcom,pm8008-chip";
					reg = <0x900>;

					qcom,pm8008-chip-en {
						regulator-name = "pm8008j-chip-en";
						phandle = <0x27>;
					};
				};

				qcom,revid@100 {
					compatible = "qcom,qpnp-revid";
					reg = <0x100>;
				};
			};

			pm8008j@d {
				compatible = "qcom,i2c-pmic";
				reg = <0x0d>;
				#address-cells = <0x01>;
				#size-cells = <0x00>;

				qcom,pm8008j-regulator {
					compatible = "qcom,pm8008-regulator";
					#address-cells = <0x01>;
					#size-cells = <0x00>;
					pm8008_en-supply = <0x27>;
					vdd_l1_l2-supply = <0xffffffff>;
					vdd_l3_l4-supply = <0xffffffff>;
					vdd_l5-supply = <0xffffffff>;
					vdd_l6-supply = <0xffffffff>;
					vdd_l7-supply = <0xffffffff>;

					regulator@4000 {
						reg = <0x4000>;
						regulator-name = "pm8008j_l1";
						regulator-min-microvolt = <0x101d00>;
						regulator-max-microvolt = <0x101d00>;
						qcom,min-dropout-voltage = <0xfa00>;
						qcom,hpm-min-load = <0x00>;
						phandle = <0x6f>;
					};

					regulator@4100 {
						reg = <0x4100>;
						regulator-name = "pm8008j_l2";
						regulator-min-microvolt = <0x101d00>;
						regulator-max-microvolt = <0x101d00>;
						qcom,min-dropout-voltage = <0x5dc0>;
						qcom,hpm-min-load = <0x00>;
						phandle = <0x70>;
					};

					regulator@4200 {
						reg = <0x4200>;
						regulator-name = "pm8008j_l3";
						regulator-min-microvolt = <0x325aa0>;
						regulator-max-microvolt = <0x326a40>;
						qcom,min-dropout-voltage = <0x36b00>;
						qcom,hpm-min-load = <0x00>;
						phandle = <0x71>;
					};

					regulator@4300 {
						reg = <0x4300>;
						regulator-name = "pm8008j_l4";
						regulator-min-microvolt = <0x2ad8c0>;
						regulator-max-microvolt = <0x2ad8c0>;
						qcom,min-dropout-voltage = <0x2ee00>;
						qcom,hpm-min-load = <0x00>;
						phandle = <0x72>;
					};

					regulator@4400 {
						reg = <0x4400>;
						regulator-name = "pm8008j_l5";
						regulator-min-microvolt = <0x1b7740>;
						regulator-max-microvolt = <0x1b7740>;
						qcom,min-dropout-voltage = <0xdac0>;
						qcom,hpm-min-load = <0x00>;
						phandle = <0x73>;
					};

					regulator@4500 {
						reg = <0x4500>;
						regulator-name = "pm8008j_l6";
						regulator-min-microvolt = "\0/]";
						regulator-max-microvolt = "\0/]";
						qcom,min-dropout-voltage = <0x1d4c0>;
						qcom,hpm-min-load = <0x00>;
						phandle = <0x74>;
					};

					regulator@4600 {
						reg = <0x4600>;
						regulator-name = "pm8008j_l7";
						regulator-min-microvolt = "\0/]";
						regulator-max-microvolt = "\0/]";
						qcom,min-dropout-voltage = <0x17700>;
						qcom,hpm-min-load = <0x00>;
						phandle = <0x75>;
					};
				};
			};
		};
	};

	fragment@29 {
		target = <0xffffffff>;

		__overlay__ {
			status = "disabled";
		};
	};

	fragment@30 {
		target = <0xffffffff>;

		__overlay__ {

			cnss_host_sol_default {
				phandle = <0x28>;

				mux {
					pins = "gpio48";
					function = "gpio";
				};

				config {
					pins = "gpio48";
					drive-strength = <0x04>;
					bias-pull-down;
				};
			};

			cnss_dev_sol_default {
				phandle = <0x29>;

				mux {
					pins = "gpio50";
					function = "gpio";
				};

				config {
					pins = "gpio50";
					drive-strength = <0x04>;
					bias-pull-down;
				};
			};
		};
	};

	fragment@31 {
		target = <0xffffffff>;

		__overlay__ {

			qcom,cnss-wcn7850@b0000000 {
				compatible = "qcom,cnss-wcn7850";
				reg = <0xb0000000 0x10000>;
				reg-names = "smmu_iova_ipa";
				wlan-en-gpio = <0xffffffff 0x50 0x00>;
				wlan-host-sol-gpio = <0xffffffff 0x30 0x00>;
				wlan-dev-sol-gpio = <0xffffffff 0x32 0x00>;
				pinctrl-names = "wlan_en_active\0wlan_en_sleep\0sol_default";
				pinctrl-0 = <0xffffffff>;
				pinctrl-1 = <0xffffffff>;
				pinctrl-2 = <0x28 0x29>;
				qcom,wlan;
				qcom,wlan-rc-num = <0x01>;
				qcom,wlan-ramdump-dynamic = <0x780000>;
				use-pm-domain;
				qcom,same-dt-multi-dev;
				mboxes = <0xffffffff 0x00>;
				vdd-wlan-io-supply = <0xffffffff>;
				qcom,vdd-wlan-io-config = <0x1b7740 0x1b7740 0x00 0x00 0x00>;
				vdd-wlan-supply = <0xffffffff>;
				qcom,vdd-wlan-config = <0xf4240 0xf4240 0x00 0x00 0x00>;
				vdd-wlan-aon-supply = <0xffffffff>;
				qcom,vdd-wlan-aon-config = <0xef420 0xfde80 0x00 0x00 0x00>;
				vdd-wlan-dig-supply = <0xffffffff>;
				qcom,vdd-wlan-dig-config = <0xe7ef0 0x11da50 0x00 0x00 0x00>;
				vdd-wlan-rfa1-supply = <0xffffffff>;
				qcom,vdd-wlan-rfa1-config = <0x1cfde0 0x1ee240 0x00 0x00 0x00>;
				vdd-wlan-rfa2-supply = <0xffffffff>;
				qcom,vdd-wlan-rfa2-config = <0x149970 0x1f20c0 0x00 0x00 0x00>;
				interconnects = <0xffffffff 0x34 0xffffffff 0x23c 0xffffffff 0x1d 0xffffffff 0x200>;
				interconnect-names = "pcie_to_memnoc\0memnoc_to_ddr";
				qcom,icc-path-count = <0x02>;
				qcom,bus-bw-cfg-count = <0x09>;
				qcom,bus-bw-cfg = <0x00 0x00 0x8ca 0x186a00 0x1d4c 0x186a00 0x7530 0x186a00 0x186a0 0x626380 0x2ab98 0x626380 0x2ab98 0x626380 0x2ab98 0x822080 0x1d4c 0x30d400 0x00 0x00 0x8ca 0x1b8a00 0x1d4c 0x1b8a00 0x7530 0x1b8a00 0x186a0 0x1b8a00 0x2ab98 0x5eec00 0x2ab98 0x7faf80 0x2ab98 0xc35000 0x1d4c 0x216600>;
				phandle = <0x76>;
			};
		};
	};

	fragment@32 {
		target = <0xffffffff>;

		__overlay__ {
			#address-cells = <0x05>;
			#size-cells = <0x00>;

			cnss_pci1 {
				reg = <0x00 0x00 0x00 0x00 0x00>;
				qcom,iommu-group = <0x2a>;
				memory-region = <0xffffffff>;
				#address-cells = <0x01>;
				#size-cells = <0x01>;
				phandle = <0x77>;

				cnss_pci_iommu_group1 {
					qcom,iommu-msi-size = <0x1000>;
					qcom,iommu-dma-addr-pool = <0xa0000000 0x10000000>;
					qcom,iommu-dma = "fastmap";
					qcom,iommu-pagetable = "coherent";
					qcom,iommu-faults = "stall-disable\0HUPCF\0no-CFRE\0non-fatal";
					phandle = <0x2a>;
				};
			};
		};
	};

	__symbols__ {
		pmk8350 = "/fragment@0/__overlay__/qcom,pmk8350@0";
		pmk8350_vadc = "/fragment@0/__overlay__/qcom,pmk8350@0/vadc@3100";
		pmk8350_adc_tm = "/fragment@0/__overlay__/qcom,pmk8350@0/adc_tm@3400";
		pmk8350_sdam_1 = "/fragment@0/__overlay__/qcom,pmk8350@0/sdam@7000";
		pmk8350_sdam_2 = "/fragment@0/__overlay__/qcom,pmk8350@0/sdam@7100";
		restart_reason = "/fragment@0/__overlay__/qcom,pmk8350@0/sdam@7100/restart@48";
		hap_cl_brake = "/fragment@0/__overlay__/qcom,pmk8350@0/sdam@7100/cl_brake@7c";
		pmk8350_sdam_5 = "/fragment@0/__overlay__/qcom,pmk8350@0/sdam@7400";
		pmk8350_sdam_13 = "/fragment@0/__overlay__/qcom,pmk8350@0/sdam@7c00";
		pmk8350_sdam_14 = "/fragment@0/__overlay__/qcom,pmk8350@0/sdam@7d00";
		pmk8350_sdam_21 = "/fragment@0/__overlay__/qcom,pmk8350@0/sdam@8400";
		pmk8350_sdam_22 = "/fragment@0/__overlay__/qcom,pmk8350@0/sdam@8500";
		pmk8350_sdam_23 = "/fragment@0/__overlay__/qcom,pmk8350@0/sdam@8600";
		adc_scaling = "/fragment@0/__overlay__/qcom,pmk8350@0/sdam@8600/scaling@bf";
		pmk8350_sdam_41 = "/fragment@0/__overlay__/qcom,pmk8350@0/sdam@9800";
		pmk8350_sdam_46 = "/fragment@0/__overlay__/qcom,pmk8350@0/sdam@9d00";
		pmk8350_gpios = "/fragment@0/__overlay__/qcom,pmk8350@0/pinctrl@b000";
		pmk8350_rtc = "/fragment@0/__overlay__/qcom,pmk8350@0/rtc@6100";
		pm8350_tz = "/fragment@1/__overlay__/qcom,pm8350@1/qcom,temp-alarm@a00";
		pm8350_gpios = "/fragment@1/__overlay__/qcom,pm8350@1/pinctrl@8800";
		pm8350_rear_tof_therm_default = "/fragment@1/__overlay__/qcom,pm8350@1/pinctrl@8800/pm8350_rear_tof_therm/pm8350_rear_tof_therm_default";
		key_vol_up_default = "/fragment@1/__overlay__/qcom,pm8350@1/pinctrl@8800/key_vol_up/key_vol_up_default";
		pm8350_temp_alarm = "/fragment@2/__overlay__/pm8350_tz";
		pm8350_trip0 = "/fragment@2/__overlay__/pm8350_tz/trips/trip0";
		pm8350_trip1 = "/fragment@2/__overlay__/pm8350_tz/trips/trip1";
		pm8350_trip2 = "/fragment@2/__overlay__/pm8350_tz/trips/trip2";
		pm8350c_tz = "/fragment@3/__overlay__/qcom,pm8350c@2/qcom,temp-alarm@a00";
		pm8350c_gpios = "/fragment@3/__overlay__/qcom,pm8350c@2/pinctrl@8800";
		lcd_backlight_ctrl_default = "/fragment@3/__overlay__/qcom,pm8350c@2/pinctrl@8800/lcd_backlight_ctrl/lcd_backlight_ctrl_default";
		eusb2_reset_ctrl_default = "/fragment@3/__overlay__/qcom,pm8350c@2/pinctrl@8800/eusb2_reset_ctrl/eusb2_reset_ctrl_default";
		pm8350c_pwm_1 = "/fragment@3/__overlay__/qcom,pm8350c@2/pwms@e800";
		pm8350c_pwm_2 = "/fragment@3/__overlay__/qcom,pm8350c@2/pwms@eb00";
		pm8350c_rgb = "/fragment@3/__overlay__/qcom,pm8350c@2/qcom,leds@ef00";
		pm8350c_bcl = "/fragment@3/__overlay__/qcom,pm8350c@2/bcl@4700";
		pm8350c_flash = "/fragment@3/__overlay__/qcom,pm8350c@2/qcom,flash_led@ee00";
		pm8350c_flash0 = "/fragment@3/__overlay__/qcom,pm8350c@2/qcom,flash_led@ee00/qcom,flash_0";
		pm8350c_flash1 = "/fragment@3/__overlay__/qcom,pm8350c@2/qcom,flash_led@ee00/qcom,flash_1";
		pm8350c_flash2 = "/fragment@3/__overlay__/qcom,pm8350c@2/qcom,flash_led@ee00/qcom,flash_2";
		pm8350c_flash3 = "/fragment@3/__overlay__/qcom,pm8350c@2/qcom,flash_led@ee00/qcom,flash_3";
		pm8350c_torch0 = "/fragment@3/__overlay__/qcom,pm8350c@2/qcom,flash_led@ee00/qcom,torch_0";
		pm8350c_torch1 = "/fragment@3/__overlay__/qcom,pm8350c@2/qcom,flash_led@ee00/qcom,torch_1";
		pm8350c_torch2 = "/fragment@3/__overlay__/qcom,pm8350c@2/qcom,flash_led@ee00/qcom,torch_2";
		pm8350c_torch3 = "/fragment@3/__overlay__/qcom,pm8350c@2/qcom,flash_led@ee00/qcom,torch_3";
		pm8350c_switch0 = "/fragment@3/__overlay__/qcom,pm8350c@2/qcom,flash_led@ee00/qcom,led_switch_0";
		pm8350c_switch1 = "/fragment@3/__overlay__/qcom,pm8350c@2/qcom,flash_led@ee00/qcom,led_switch_1";
		pm8350c_switch2 = "/fragment@3/__overlay__/qcom,pm8350c@2/qcom,flash_led@ee00/qcom,led_switch_2";
		pm8350c_temp_alarm = "/fragment@4/__overlay__/pm8350c_tz";
		pm8350c_trip0 = "/fragment@4/__overlay__/pm8350c_tz/trips/trip0";
		pm8350c_trip1 = "/fragment@4/__overlay__/pm8350c_tz/trips/trip1";
		pm8350c_trip2 = "/fragment@4/__overlay__/pm8350c_tz/trips/trip2";
		c_bcl_lvl0 = "/fragment@4/__overlay__/pm8350c-bcl-lvl0/trips/c-bcl-lvl0";
		c_bcl_lvl1 = "/fragment@4/__overlay__/pm8350c-bcl-lvl1/trips/c-bcl-lvl1";
		c_bcl_lvl2 = "/fragment@4/__overlay__/pm8350c-bcl-lvl2/trips/c-bcl-lvl2";
		pm8350b_tz = "/fragment@5/__overlay__/qcom,pm8350b@3/qcom,temp-alarm@a00";
		pm8350b_pbs2 = "/fragment@5/__overlay__/qcom,pm8350b@3/qcom,pbs@1900";
		pm8350b_gpios = "/fragment@5/__overlay__/qcom,pm8350b@3/pinctrl@8800";
		pm8350b_rear_tof_therm_default = "/fragment@5/__overlay__/qcom,pm8350b@3/pinctrl@8800/pm8350b_rear_tof_therm/pm8350b_rear_tof_therm_default";
		pm8350b_bcl = "/fragment@5/__overlay__/qcom,pm8350b@3/bcl@4700";
		bcl_soc = "/fragment@5/__overlay__/qcom,pm8350b@3/bcl-soc";
		pm8350b_haptics = "/fragment@5/__overlay__/qcom,pm8350b@3/qcom,hv-haptics@f000";
		hap_swr_slave_reg = "/fragment@5/__overlay__/qcom,pm8350b@3/qcom,hv-haptics@f000/qcom,hap-swr-slave-reg";
		pm8350b_amoled = "/fragment@5/__overlay__/qcom,pm8350b@3/qcom,amoled";
		oledb_vreg = "/fragment@5/__overlay__/qcom,pm8350b@3/qcom,amoled/oledb@fa00";
		ab_vreg = "/fragment@5/__overlay__/qcom,pm8350b@3/qcom,amoled/ab@f900";
		ibb_vreg = "/fragment@5/__overlay__/qcom,pm8350b@3/qcom,amoled/ibb@f800";
		pm8350b_temp_alarm = "/fragment@6/__overlay__/pm8350b_tz";
		pm8350b_trip0 = "/fragment@6/__overlay__/pm8350b_tz/trips/trip0";
		pm8350b_trip1 = "/fragment@6/__overlay__/pm8350b_tz/trips/trip1";
		pm8350b_trip2 = "/fragment@6/__overlay__/pm8350b_tz/trips/trip2";
		ibat_lvl0 = "/fragment@6/__overlay__/pm8350b-ibat-lvl0/trips/ibat-lvl0";
		ibat_lvl1 = "/fragment@6/__overlay__/pm8350b-ibat-lvl1/trips/ibat-lvl1";
		b_bcl_lvl0 = "/fragment@6/__overlay__/pm8350b-bcl-lvl0/trips/b-bcl-lvl0";
		b_bcl_lvl1 = "/fragment@6/__overlay__/pm8350b-bcl-lvl1/trips/b-bcl-lvl1";
		b_bcl_lvl2 = "/fragment@6/__overlay__/pm8350b-bcl-lvl2/trips/b-bcl-lvl2";
		socd_trip = "/fragment@6/__overlay__/socd/trips/socd-trip";
		pmr735a_spmi = "/fragment@7/__overlay__/qcom,pmr735a@4";
		pmr735a_tz = "/fragment@7/__overlay__/qcom,pmr735a@4/qcom,temp-alarm@a00";
		pmr735a_gpios = "/fragment@7/__overlay__/qcom,pmr735a@4/pinctrl@8800";
		pmr735a_temp_alarm = "/fragment@8/__overlay__/pmr735a_tz";
		pmr735a_trip0 = "/fragment@8/__overlay__/pmr735a_tz/trips/trip0";
		pmr735a_trip1 = "/fragment@8/__overlay__/pmr735a_tz/trips/trip1";
		pmr735a_trip2 = "/fragment@8/__overlay__/pmr735a_tz/trips/trip2";
		pmr735b_tz = "/fragment@9/__overlay__/qcom,pmr735b@5/qcom,temp-alarm@a00";
		pmr735b_gpios = "/fragment@9/__overlay__/qcom,pmr735b@5/pinctrl@8800";
		pmr735b_temp_alarm = "/fragment@10/__overlay__/pmr735b_tz";
		pmr735b_trip0 = "/fragment@10/__overlay__/pmr735b_tz/trips/trip0";
		pmr735b_trip1 = "/fragment@10/__overlay__/pmr735b_tz/trips/trip1";
		pmr735b_trip2 = "/fragment@10/__overlay__/pmr735b_tz/trips/trip2";
		pm8450_tz = "/fragment@11/__overlay__/qcom,pm8450@7/qcom,temp-alarm@a00";
		pm8450_gpios = "/fragment@11/__overlay__/qcom,pm8450@7/pinctrl@8800";
		pm8450_temp_alarm = "/fragment@12/__overlay__/pm8450_tz";
		pm8450_trip0 = "/fragment@12/__overlay__/pm8450_tz/trips/trip0";
		pm8450_trip1 = "/fragment@12/__overlay__/pm8450_tz/trips/trip1";
		pm8450_trip2 = "/fragment@12/__overlay__/pm8450_tz/trips/trip2";
		nxp_eusb2_repeater = "/fragment@22/__overlay__/eusb2_repeater@4f";
		usb_port0 = "/fragment@24/__overlay__/port/endpoint";
		usb_port0_connector = "/fragment@25/__overlay__/connector/port/endpoint";
		PM8008I_EN = "/fragment@28/__overlay__/pm8008i@8/pm8008-chip@900/qcom,pm8008-chip-en";
		L1I = "/fragment@28/__overlay__/pm8008i@9/qcom,pm8008i-regulator/regulator@4000";
		pm8008i_l1 = "/fragment@28/__overlay__/pm8008i@9/qcom,pm8008i-regulator/regulator@4000";
		L2I = "/fragment@28/__overlay__/pm8008i@9/qcom,pm8008i-regulator/regulator@4100";
		pm8008i_l2 = "/fragment@28/__overlay__/pm8008i@9/qcom,pm8008i-regulator/regulator@4100";
		L3I = "/fragment@28/__overlay__/pm8008i@9/qcom,pm8008i-regulator/regulator@4200";
		pm8008i_l3 = "/fragment@28/__overlay__/pm8008i@9/qcom,pm8008i-regulator/regulator@4200";
		L4I = "/fragment@28/__overlay__/pm8008i@9/qcom,pm8008i-regulator/regulator@4300";
		pm8008i_l4 = "/fragment@28/__overlay__/pm8008i@9/qcom,pm8008i-regulator/regulator@4300";
		L5I = "/fragment@28/__overlay__/pm8008i@9/qcom,pm8008i-regulator/regulator@4400";
		pm8008i_l5 = "/fragment@28/__overlay__/pm8008i@9/qcom,pm8008i-regulator/regulator@4400";
		L6I = "/fragment@28/__overlay__/pm8008i@9/qcom,pm8008i-regulator/regulator@4500";
		pm8008i_l6 = "/fragment@28/__overlay__/pm8008i@9/qcom,pm8008i-regulator/regulator@4500";
		L7I = "/fragment@28/__overlay__/pm8008i@9/qcom,pm8008i-regulator/regulator@4600";
		pm8008i_l7 = "/fragment@28/__overlay__/pm8008i@9/qcom,pm8008i-regulator/regulator@4600";
		PM8008J_EN = "/fragment@28/__overlay__/pm8008j@c/pm8008-chip@900/qcom,pm8008-chip-en";
		L1J = "/fragment@28/__overlay__/pm8008j@d/qcom,pm8008j-regulator/regulator@4000";
		pm8008j_l1 = "/fragment@28/__overlay__/pm8008j@d/qcom,pm8008j-regulator/regulator@4000";
		L2J = "/fragment@28/__overlay__/pm8008j@d/qcom,pm8008j-regulator/regulator@4100";
		pm8008j_l2 = "/fragment@28/__overlay__/pm8008j@d/qcom,pm8008j-regulator/regulator@4100";
		L3J = "/fragment@28/__overlay__/pm8008j@d/qcom,pm8008j-regulator/regulator@4200";
		pm8008j_l3 = "/fragment@28/__overlay__/pm8008j@d/qcom,pm8008j-regulator/regulator@4200";
		L4J = "/fragment@28/__overlay__/pm8008j@d/qcom,pm8008j-regulator/regulator@4300";
		pm8008j_l4 = "/fragment@28/__overlay__/pm8008j@d/qcom,pm8008j-regulator/regulator@4300";
		L5J = "/fragment@28/__overlay__/pm8008j@d/qcom,pm8008j-regulator/regulator@4400";
		pm8008j_l5 = "/fragment@28/__overlay__/pm8008j@d/qcom,pm8008j-regulator/regulator@4400";
		L6J = "/fragment@28/__overlay__/pm8008j@d/qcom,pm8008j-regulator/regulator@4500";
		pm8008j_l6 = "/fragment@28/__overlay__/pm8008j@d/qcom,pm8008j-regulator/regulator@4500";
		L7J = "/fragment@28/__overlay__/pm8008j@d/qcom,pm8008j-regulator/regulator@4600";
		pm8008j_l7 = "/fragment@28/__overlay__/pm8008j@d/qcom,pm8008j-regulator/regulator@4600";
		cnss_host_sol_default = "/fragment@30/__overlay__/cnss_host_sol_default";
		cnss_dev_sol_default = "/fragment@30/__overlay__/cnss_dev_sol_default";
		wlan_wcn7850 = "/fragment@31/__overlay__/qcom,cnss-wcn7850@b0000000";
		cnss_pci1 = "/fragment@32/__overlay__/cnss_pci1";
		cnss_pci_iommu_group1 = "/fragment@32/__overlay__/cnss_pci1/cnss_pci_iommu_group1";
	};

	__fixups__ {
		spmi_bus = "/fragment@0:target:0\0/fragment@1:target:0\0/fragment@3:target:0\0/fragment@5:target:0\0/fragment@7:target:0\0/fragment@9:target:0\0/fragment@11:target:0";
		thermal_zones = "/fragment@2:target:0\0/fragment@4:target:0\0/fragment@6:target:0\0/fragment@8:target:0\0/fragment@10:target:0\0/fragment@12:target:0\0/fragment@14:target:0\0/fragment@26:target:0";
		soc = "/fragment@13:target:0\0/fragment@15:target:0\0/fragment@31:target:0";
		modem_lte_dsc = "/fragment@14/__overlay__/pm8350b-bcl-lvl0/cooling-maps/vbat_lte0:cooling-device:0\0/fragment@14/__overlay__/pm8350b-bcl-lvl1/cooling-maps/vbat_lte1:cooling-device:0\0/fragment@14/__overlay__/pm8350c-bcl-lvl0/cooling-maps/vph_lte0:cooling-device:0\0/fragment@14/__overlay__/pm8350c-bcl-lvl1/cooling-maps/vph_lte1:cooling-device:0\0/fragment@14/__overlay__/pm8350c_tz/cooling-maps/pm8350c_lte:cooling-device:0";
		modem_nr_scg_dsc = "/fragment@14/__overlay__/pm8350b-bcl-lvl0/cooling-maps/vbat_nr0_scg:cooling-device:0\0/fragment@14/__overlay__/pm8350b-bcl-lvl1/cooling-maps/vbat_nr1_scg:cooling-device:0\0/fragment@14/__overlay__/pm8350c-bcl-lvl0/cooling-maps/vph_nr0_scg:cooling-device:0\0/fragment@14/__overlay__/pm8350c-bcl-lvl1/cooling-maps/vph_nr1_scg:cooling-device:0\0/fragment@14/__overlay__/pm8350c_tz/cooling-maps/pm8350c_nr:cooling-device:0";
		modem_nr_dsc = "/fragment@14/__overlay__/pm8350b-bcl-lvl0/cooling-maps/vbat_nr0:cooling-device:0\0/fragment@14/__overlay__/pm8350b-bcl-lvl1/cooling-maps/vbat_nr1:cooling-device:0\0/fragment@14/__overlay__/pm8350c-bcl-lvl0/cooling-maps/vph_nr0:cooling-device:0\0/fragment@14/__overlay__/pm8350c-bcl-lvl1/cooling-maps/vph_nr1:cooling-device:0";
		cdsp_sw = "/fragment@14/__overlay__/pm8350b-bcl-lvl0/cooling-maps/vbat_cdsp0:cooling-device:0\0/fragment@14/__overlay__/pm8350b-bcl-lvl1/cooling-maps/vbat_cdsp1:cooling-device:0\0/fragment@14/__overlay__/pm8350b-bcl-lvl2/cooling-maps/vbat_cdsp2:cooling-device:0\0/fragment@14/__overlay__/pm8350c-bcl-lvl0/cooling-maps/vph_cdsp0:cooling-device:0\0/fragment@14/__overlay__/pm8350c-bcl-lvl1/cooling-maps/vph_cdsp1:cooling-device:0\0/fragment@14/__overlay__/pm8350c-bcl-lvl2/cooling-maps/vph_cdsp2:cooling-device:0\0/fragment@14/__overlay__/pm8350c_tz/cooling-maps/pm8350c_nsp:cooling-device:0";
		cpu5_pause = "/fragment@14/__overlay__/pm8350b-bcl-lvl0/cooling-maps/vbat_cpu_5:cooling-device:0\0/fragment@14/__overlay__/pm8350c-bcl-lvl0/cooling-maps/vph_cpu_5:cooling-device:0";
		msm_gpu = "/fragment@14/__overlay__/pm8350b-bcl-lvl0/cooling-maps/vbat_gpu0:cooling-device:0\0/fragment@14/__overlay__/pm8350b-bcl-lvl1/cooling-maps/vbat_gpu1:cooling-device:0\0/fragment@14/__overlay__/pm8350b-bcl-lvl2/cooling-maps/vbat_gpu2:cooling-device:0\0/fragment@14/__overlay__/pm8350c-bcl-lvl0/cooling-maps/vph_gpu0:cooling-device:0\0/fragment@14/__overlay__/pm8350c-bcl-lvl1/cooling-maps/vph_gpu1:cooling-device:0\0/fragment@14/__overlay__/pm8350c-bcl-lvl2/cooling-maps/vph_gpu2:cooling-device:0\0/fragment@14/__overlay__/pm8350_tz/cooling-maps/pm8350_gpu:cooling-device:0\0/fragment@26/__overlay__/pm8350b-bcl-lvl2/cooling-maps/vbat_gpu2:cooling-device:0\0/fragment@26/__overlay__/pm8350c-bcl-lvl2/cooling-maps/vph_gpu2:cooling-device:0";
		cpu_6_7_pause = "/fragment@14/__overlay__/pm8350b-bcl-lvl1/cooling-maps/vbat_cpu_6_7:cooling-device:0\0/fragment@14/__overlay__/pm8350c-bcl-lvl1/cooling-maps/vph_cpu_6_7:cooling-device:0";
		CPU4 = "/fragment@14/__overlay__/pm8450_tz/cooling-maps/pm8450_cpu4_freq:cooling-device:0\0/fragment@14/__overlay__/pm8350_tz/cooling-maps/pm8350_cpu4_freq:cooling-device:0";
		CPU5 = "/fragment@14/__overlay__/pm8450_tz/cooling-maps/pm8450_cpu5_freq:cooling-device:0\0/fragment@14/__overlay__/pm8350_tz/cooling-maps/pm8350_cpu5_freq:cooling-device:0";
		CPU6 = "/fragment@14/__overlay__/pm8450_tz/cooling-maps/pm8450_cpu6_freq:cooling-device:0\0/fragment@14/__overlay__/pm8350_tz/cooling-maps/pm8350_cpu6_freq:cooling-device:0";
		CPU7 = "/fragment@14/__overlay__/pm8450_tz/cooling-maps/pm8450_cpu7_freq:cooling-device:0\0/fragment@14/__overlay__/pm8350_tz/cooling-maps/pm8350_cpu7_freq:cooling-device:0";
		APC1_pause = "/fragment@14/__overlay__/pm8450_tz/cooling-maps/pm8450_apc1:cooling-device:0\0/fragment@14/__overlay__/pm8350_tz/cooling-maps/pm8350_apc1:cooling-device:0";
		sdhc_2 = "/fragment@16:target:0";
		L9C = "/fragment@16/__overlay__:vdd-supply:0";
		L6C = "/fragment@16/__overlay__:vdd-io-supply:0";
		sdc2_on = "/fragment@16/__overlay__:pinctrl-0:0";
		sdc2_off = "/fragment@16/__overlay__:pinctrl-1:0";
		tlmm = "/fragment@16/__overlay__:cd-gpios:0\0/fragment@20/__overlay__/nq@28:qcom,sn-irq:0\0/fragment@20/__overlay__/nq@28:qcom,sn-ven:0\0/fragment@20/__overlay__/nq@28:qcom,sn-firm:0\0/fragment@20/__overlay__/nq@28:qcom,sn-clkreq:0\0/fragment@20/__overlay__/nq@28:interrupt-parent:0\0/fragment@21/__overlay__/focaltech@0:interrupt-parent:0\0/fragment@21/__overlay__/focaltech@0:focaltech,reset-gpio:0\0/fragment@21/__overlay__/focaltech@0:focaltech,irq-gpio:0\0/fragment@31/__overlay__/qcom,cnss-wcn7850@b0000000:wlan-en-gpio:0\0/fragment@31/__overlay__/qcom,cnss-wcn7850@b0000000:wlan-host-sol-gpio:0\0/fragment@31/__overlay__/qcom,cnss-wcn7850@b0000000:wlan-dev-sol-gpio:0";
		ufsphy_mem = "/fragment@17:target:0";
		L5B = "/fragment@17/__overlay__:vdda-phy-supply:0";
		L10C = "/fragment@17/__overlay__:vdda-pll-supply:0";
		ufshc_mem = "/fragment@18:target:0";
		gcc_ufs_phy_gdsc = "/fragment@18/__overlay__:vdd-hba-supply:0";
		L7B = "/fragment@18/__overlay__:vcc-supply:0";
		L9B = "/fragment@18/__overlay__:vccq-supply:0\0/fragment@18/__overlay__:qcom,vddp-ref-clk-supply:0";
		battery_charger = "/fragment@19:target:0";
		qupv3_se9_i2c = "/fragment@20:target:0";
		S10B = "/fragment@20/__overlay__/nq@28:qcom,sn-vdd-1p8-supply:0\0/fragment@22/__overlay__/eusb2_repeater@4f:vdd18-supply:0\0/fragment@31/__overlay__/qcom,cnss-wcn7850@b0000000:vdd-wlan-io-supply:0";
		nfc_int_active = "/fragment@20/__overlay__/nq@28:pinctrl-0:0";
		nfc_enable_active = "/fragment@20/__overlay__/nq@28:pinctrl-0:4";
		nfc_int_suspend = "/fragment@20/__overlay__/nq@28:pinctrl-1:0";
		nfc_enable_suspend = "/fragment@20/__overlay__/nq@28:pinctrl-1:4";
		qupv3_se4_spi = "/fragment@21:target:0";
		L3C = "/fragment@21/__overlay__/focaltech@0:vdd-supply:0";
		ts_active = "/fragment@21/__overlay__/focaltech@0:pinctrl-0:0";
		ts_int_suspend = "/fragment@21/__overlay__/focaltech@0:pinctrl-1:0";
		ts_reset_suspend = "/fragment@21/__overlay__/focaltech@0:pinctrl-1:4";
		ts_release = "/fragment@21/__overlay__/focaltech@0:pinctrl-2:0";
		qupv3_se5_i2c = "/fragment@22:target:0\0/fragment@27/__overlay__:qcom,critical-devices:0\0/fragment@28:target:0";
		L2B = "/fragment@22/__overlay__/eusb2_repeater@4f:vdd3-supply:0";
		eusb2_phy0 = "/fragment@23:target:0";
		usb0 = "/fragment@24:target:0";
		ucsi = "/fragment@25:target:0";
		clock_gcc = "/fragment@27:target:0";
		pm8008i_active = "/fragment@28/__overlay__/pm8008i@8:pinctrl-0:0";
		S12B = "/fragment@28/__overlay__/pm8008i@9/qcom,pm8008i-regulator:vdd_l1_l2-supply:0\0/fragment@28/__overlay__/pm8008j@d/qcom,pm8008j-regulator:vdd_l1_l2-supply:0\0/fragment@31/__overlay__/qcom,cnss-wcn7850@b0000000:vdd-wlan-rfa2-supply:0";
		BOB = "/fragment@28/__overlay__/pm8008i@9/qcom,pm8008i-regulator:vdd_l3_l4-supply:0\0/fragment@28/__overlay__/pm8008i@9/qcom,pm8008i-regulator:vdd_l6-supply:0\0/fragment@28/__overlay__/pm8008i@9/qcom,pm8008i-regulator:vdd_l7-supply:0\0/fragment@28/__overlay__/pm8008j@d/qcom,pm8008j-regulator:vdd_l3_l4-supply:0\0/fragment@28/__overlay__/pm8008j@d/qcom,pm8008j-regulator:vdd_l6-supply:0\0/fragment@28/__overlay__/pm8008j@d/qcom,pm8008j-regulator:vdd_l7-supply:0";
		S1C = "/fragment@28/__overlay__/pm8008i@9/qcom,pm8008i-regulator:vdd_l5-supply:0\0/fragment@28/__overlay__/pm8008j@d/qcom,pm8008j-regulator:vdd_l5-supply:0\0/fragment@31/__overlay__/qcom,cnss-wcn7850@b0000000:vdd-wlan-rfa1-supply:0";
		pm8008j_active = "/fragment@28/__overlay__/pm8008j@c:pinctrl-0:0";
		wlan = "/fragment@29:target:0";
		cnss_pins = "/fragment@30:target:0";
		cnss_wlan_en_active = "/fragment@31/__overlay__/qcom,cnss-wcn7850@b0000000:pinctrl-0:0";
		cnss_wlan_en_sleep = "/fragment@31/__overlay__/qcom,cnss-wcn7850@b0000000:pinctrl-1:0";
		qmp_aop = "/fragment@31/__overlay__/qcom,cnss-wcn7850@b0000000:mboxes:0";
		S3E = "/fragment@31/__overlay__/qcom,cnss-wcn7850@b0000000:vdd-wlan-supply:0";
		S2E = "/fragment@31/__overlay__/qcom,cnss-wcn7850@b0000000:vdd-wlan-aon-supply:0";
		S11B = "/fragment@31/__overlay__/qcom,cnss-wcn7850@b0000000:vdd-wlan-dig-supply:0";
		pcie_noc = "/fragment@31/__overlay__/qcom,cnss-wcn7850@b0000000:interconnects:0\0/fragment@31/__overlay__/qcom,cnss-wcn7850@b0000000:interconnects:8";
		gem_noc = "/fragment@31/__overlay__/qcom,cnss-wcn7850@b0000000:interconnects:16";
		mc_virt = "/fragment@31/__overlay__/qcom,cnss-wcn7850@b0000000:interconnects:24";
		pcie1_rp = "/fragment@32:target:0";
		cnss_wlan_mem = "/fragment@32/__overlay__/cnss_pci1:memory-region:0";
	};

	__local_fixups__ {

		fragment@0 {

			__overlay__ {

				qcom,pmk8350@0 {

					vadc@3100 {
						pinctrl-0 = <0x00>;
					};
				};
			};
		};

		fragment@1 {

			__overlay__ {

				qcom,pm8350@1 {

					qcom,temp-alarm@a00 {
						io-channels = <0x00>;
					};
				};
			};
		};

		fragment@2 {

			__overlay__ {

				pm8350_tz {
					thermal-sensors = <0x00>;
				};
			};
		};

		fragment@3 {

			__overlay__ {

				qcom,pm8350c@2 {

					pwms@e800 {
						nvmem = <0x00 0x04>;
					};

					qcom,leds@ef00 {

						red {
							pwms = <0x00>;
						};

						green {
							pwms = <0x00>;
						};

						blue {
							pwms = <0x00>;
						};
					};
				};
			};
		};

		fragment@4 {

			__overlay__ {

				pm8350c_tz {
					thermal-sensors = <0x00>;
				};

				pm8350c-bcl-lvl0 {
					thermal-sensors = <0x00>;
				};

				pm8350c-bcl-lvl1 {
					thermal-sensors = <0x00>;
				};

				pm8350c-bcl-lvl2 {
					thermal-sensors = <0x00>;
				};
			};
		};

		fragment@5 {

			__overlay__ {

				qcom,pm8350b@3 {

					qcom,temp-alarm@a00 {
						io-channels = <0x00>;
					};

					qcom,hv-haptics@f000 {
						nvmem-cells = <0x00>;
						nvmem = <0x00>;
						qcom,pbs-client = <0x00>;
					};

					qcom,amoled-ecm@f900 {
						nvmem = <0x00 0x04 0x08>;
					};
				};
			};
		};

		fragment@6 {

			__overlay__ {

				pm8350b_tz {
					thermal-sensors = <0x00>;
				};

				pm8350b-ibat-lvl0 {
					thermal-sensors = <0x00>;
				};

				pm8350b-ibat-lvl1 {
					thermal-sensors = <0x00>;
				};

				pm8350b-bcl-lvl0 {
					thermal-sensors = <0x00>;
				};

				pm8350b-bcl-lvl1 {
					thermal-sensors = <0x00>;
				};

				pm8350b-bcl-lvl2 {
					thermal-sensors = <0x00>;
				};
			};
		};

		fragment@7 {

			__overlay__ {

				qcom,pmr735a@4 {

					qcom,temp-alarm@a00 {
						io-channels = <0x00>;
					};
				};
			};
		};

		fragment@8 {

			__overlay__ {

				pmr735a_tz {
					thermal-sensors = <0x00>;
				};
			};
		};

		fragment@9 {

			__overlay__ {

				qcom,pmr735b@5 {

					qcom,temp-alarm@a00 {
						io-channels = <0x00>;
					};
				};
			};
		};

		fragment@10 {

			__overlay__ {

				pmr735b_tz {
					thermal-sensors = <0x00>;
				};
			};
		};

		fragment@12 {

			__overlay__ {

				pm8450_tz {
					thermal-sensors = <0x00>;
				};
			};
		};

		fragment@13 {

			__overlay__ {

				reboot_reason {
					nvmem-cells = <0x00>;
				};

				pmic-pon-log {
					nvmem = <0x00>;
				};
			};
		};

		fragment@14 {

			__overlay__ {

				pm8350b-bcl-lvl0 {

					cooling-maps {

						vbat_lte0 {
							trip = <0x00>;
						};

						vbat_nr0_scg {
							trip = <0x00>;
						};

						vbat_nr0 {
							trip = <0x00>;
						};

						vbat_cdsp0 {
							trip = <0x00>;
						};

						vbat_cpu_5 {
							trip = <0x00>;
						};

						vbat_gpu0 {
							trip = <0x00>;
						};
					};
				};

				pm8350b-bcl-lvl1 {

					cooling-maps {

						vbat_lte1 {
							trip = <0x00>;
						};

						vbat_nr1_scg {
							trip = <0x00>;
						};

						vbat_nr1 {
							trip = <0x00>;
						};

						vbat_cdsp1 {
							trip = <0x00>;
						};

						vbat_cpu_6_7 {
							trip = <0x00>;
						};

						vbat_gpu1 {
							trip = <0x00>;
						};
					};
				};

				pm8350b-bcl-lvl2 {

					cooling-maps {

						vbat_cdsp2 {
							trip = <0x00>;
						};

						vbat_gpu2 {
							trip = <0x00>;
						};
					};
				};

				pm8350c-bcl-lvl0 {

					cooling-maps {

						vph_lte0 {
							trip = <0x00>;
						};

						vph_nr0_scg {
							trip = <0x00>;
						};

						vph_nr0 {
							trip = <0x00>;
						};

						vph_cdsp0 {
							trip = <0x00>;
						};

						vph_cpu_5 {
							trip = <0x00>;
						};

						vph_gpu0 {
							trip = <0x00>;
						};
					};
				};

				pm8350c-bcl-lvl1 {

					cooling-maps {

						vph_lte1 {
							trip = <0x00>;
						};

						vph_nr1_scg {
							trip = <0x00>;
						};

						vph_nr1 {
							trip = <0x00>;
						};

						vph_cdsp1 {
							trip = <0x00>;
						};

						vph_cpu_6_7 {
							trip = <0x00>;
						};

						vph_gpu1 {
							trip = <0x00>;
						};
					};
				};

				pm8350c-bcl-lvl2 {

					cooling-maps {

						vph_cdsp2 {
							trip = <0x00>;
						};

						vph_gpu2 {
							trip = <0x00>;
						};
					};
				};

				pm8450_tz {

					cooling-maps {

						pm8450_cpu4_freq {
							trip = <0x00>;
						};

						pm8450_cpu5_freq {
							trip = <0x00>;
						};

						pm8450_cpu6_freq {
							trip = <0x00>;
						};

						pm8450_cpu7_freq {
							trip = <0x00>;
						};

						pm8450_apc1 {
							trip = <0x00>;
						};
					};
				};

				pm8350_tz {

					cooling-maps {

						pm8350_gpu {
							trip = <0x00>;
						};

						pm8350_cpu4_freq {
							trip = <0x00>;
						};

						pm8350_cpu5_freq {
							trip = <0x00>;
						};

						pm8350_cpu6_freq {
							trip = <0x00>;
						};

						pm8350_cpu7_freq {
							trip = <0x00>;
						};

						pm8350_apc1 {
							trip = <0x00>;
						};
					};
				};

				pm8350c_tz {

					cooling-maps {

						pm8350c_nsp {
							trip = <0x00>;
						};

						pm8350c_lte {
							trip = <0x00>;
						};

						pm8350c_nr {
							trip = <0x00>;
						};
					};
				};
			};
		};

		fragment@15 {

			__overlay__ {

				gpio_keys {
					pinctrl-0 = <0x00>;

					vol_up {
						gpios = <0x00>;
					};
				};
			};
		};

		fragment@22 {

			__overlay__ {

				eusb2_repeater@4f {
					reset-gpio = <0x00>;
					pinctrl-0 = <0x00>;
				};
			};
		};

		fragment@23 {

			__overlay__ {
				dummy-supply = <0x00>;
				usb-repeater = <0x00>;
			};
		};

		fragment@24 {

			__overlay__ {

				port {

					endpoint {
						remote-endpoint = <0x00>;
					};
				};
			};
		};

		fragment@25 {

			__overlay__ {

				connector {

					port {

						endpoint {
							remote-endpoint = <0x00>;
						};
					};
				};
			};
		};

		fragment@28 {

			__overlay__ {

				pm8008i@9 {

					qcom,pm8008i-regulator {
						pm8008_en-supply = <0x00>;
					};
				};

				pm8008j@d {

					qcom,pm8008j-regulator {
						pm8008_en-supply = <0x00>;
					};
				};
			};
		};

		fragment@31 {

			__overlay__ {

				qcom,cnss-wcn7850@b0000000 {
					pinctrl-2 = <0x00 0x04>;
				};
			};
		};

		fragment@32 {

			__overlay__ {

				cnss_pci1 {
					qcom,iommu-group = <0x00>;
				};
			};
		};
	};
};
